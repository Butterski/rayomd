/* The code fresh exports run, grouped before .text so that they fault in fewer pages.
   Generated by scripts/hot_sections.py; regenerate it with that script, never by hand.
   Names that no longer exist match nothing. */
SECTIONS
{
  .text.hot :
  {
    *(.text._ZNSt7__cxx1112basic_stringIcSt11char_traitsIcESaIcEEC2IS3_EEPKcRKS3_.constprop.0)
    *(.text._ZNKSt17basic_string_viewIcSt11char_traitsIcEE6substrEmm.isra.0)
    *(.text.unlikely._ZN7TinyPdfL21ThemeTextNeedsUnicodeERKNS_8PdfThemeE)
    *(.text.unlikely._ZNSt6vectorIZN7TinyPdfL10AddOutlineERNS0_10PdfObjectsERNSt7__cxx1112basic_stringIcSt11char_traitsIcESaIcEEERKS_INS0_11HeadingMarkESaISA_EERKS_IiSaIiEEbS9_E5EntrySaISJ_EED2Ev)
    *(.text.unlikely._ZZN7TinyPdfL10AddOutlineERNS_10PdfObjectsERNSt7__cxx1112basic_stringIcSt11char_traitsIcESaIcEEERKSt6vectorINS_11HeadingMarkESaISA_EERKS9_IiSaIiEEbS8_ENKUlPcSt17basic_string_viewIcS5_EE_clESJ_SL_.isra.0)
    *(.text.unlikely._ZNSt6vectorIS_IiSaIiEESaIS1_EE12emplace_backIJS1_EEERS1_DpOT_.isra.0)
    *(.text.unlikely._ZN7TinyPdfL23AppendMathFontResourcesERNSt7__cxx1112basic_stringIcSt11char_traitsIcESaIcEEERKSt6vectorIiSaIiEE)
    *(.text.unlikely._ZN7TinyPdfL14AppendContentsERNSt7__cxx1112basic_stringIcSt11char_traitsIcESaIcEEEiii)
    *(.text.unlikely._ZN7TinyPdfL15PagesDictionaryERKSt6vectorIiSaIiEEi)
    *(.text.unlikely._ZN7TinyPdfL15WriteTextStringEPcSt17basic_string_viewIcSt11char_traitsIcEEb)
    *(.text.unlikely._ZZN7TinyPdfL14InfoDictionaryEPKcRKNS_16DocumentMetadataERKSt6vectorINS_11HeadingMarkESaIS6_EEbENKUlSt17basic_string_viewIcSt11char_traitsIcEESE_bE_clESE_SE_b)
    *(.text.unlikely._ZN7TinyPdfL14InfoDictionaryEPKcRKNS_16DocumentMetadataERKSt6vectorINS_11HeadingMarkESaIS6_EEb)
    *(.text.unlikely._ZN7TinyPdfL16AddInternalLinksERNS_10PdfObjectsERKSt6vectorINS_12InternalLinkESaIS3_EERKS2_IiSaIiEEbPKNS_8Internal10StructTreeE)
    *(.text.unlikely._ZN7TinyPdfL19FrontMatterMetadataESt17basic_string_viewIcSt11char_traitsIcEE)
    *(.text.unlikely._ZN7TinyPdfL10AddOutlineERNS_10PdfObjectsERNSt7__cxx1112basic_stringIcSt11char_traitsIcESaIcEEERKSt6vectorINS_11HeadingMarkESaISA_EERKS9_IiSaIiEEbS8_)
    *(.text.unlikely._ZN7TinyPdfL15AddImageObjectsERNS_10PdfObjectsERKSt6vectorISt10shared_ptrIKNS_8PdfImageEESaIS6_EEiib)
    *(.text.unlikely._ZNSt6vectorIiSaIiEE12emplace_backIJiEEERiDpOT_.isra.0)
    *(.text.unlikely._ZN7TinyPdfL9ThemeLogoERKNS_8PdfThemeERNS_13ImageRegistryE)
    *(.text.unlikely._ZN7TinyPdfL24AddLinkAnnotationObjectsINS_14HeadingTargetsELb0EEESt6vectorIS2_IiSaIiEESaIS4_EERNS_10PdfObjectsERKS2_IS2_INS_8LinkRectESaIS9_EESaISB_EEbRT_RS2_INS_12InternalLinkESaISI_EEbPNS_8Internal10StructTreeE.constprop.0)
    *(.text.unlikely._ZN7TinyPdfL13BuildDocumentERKNSt7__cxx1112basic_stringIcSt11char_traitsIcESaIcEEERKNS_10PdfOptionsERS5_RNS_11BuildResultERjPNS_10BookSourceE.constprop.0)
    *libgcc_eh.a:unwind-dw2-fde-dip.o(.text.exit)
    *(.text.startup.main)
    *libstdc++.a:system_error.o(.text.startup._GLOBAL__sub_I_system_error.cc)
    *libstdc++.a:eh_alloc.o(.text.startup._GLOBAL__sub_I_eh_alloc.cc)
    *libstdc++.a:cxx11-locale-inst.o(.text.startup._GLOBAL__sub_I_cxx11_locale_inst.cc)
    *libstdc++.a:cxx11-wlocale-inst.o(.text.startup._GLOBAL__sub_I_cxx11_wlocale_inst.cc)
    *libstdc++.a:locale-inst.o(.text.startup._GLOBAL__sub_I_locale_inst.cc)
    *libstdc++.a:wlocale-inst.o(.text.startup._GLOBAL__sub_I_wlocale_inst.cc)
    *libstdc++.a:ios_errcat.o(.text.startup._GLOBAL__sub_I_ios_errcat.cc)
    *libgcc.a:cpuinfo.o(.text.startup)
    *(.text._ZN7TinyPdfL11HeadingKeepERKNS_8Internal5BlockEPS2_S4_d)
    *(.text._ZSt12__to_chars_iImENSt9enable_ifIXsrSt5__or_IJS1_IJSt7is_sameINSt9remove_cvIT_E4typeEaES2_IS6_sES2_IS6_iES2_IS6_lES2_IS6_xEEES1_IJS2_IS6_hES2_IS6_tES2_IS6_jES2_IS6_mES2_IS6_yEEES2_IS4_nES2_IS4_oES2_IcS6_EEE5valueESt15to_chars_resultE4typeEPcSQ_S4_i.constprop.0)
    *(.text._ZN7TinyPdfL19WriteEscapedLiteralEPcSt17basic_string_viewIcSt11char_traitsIcEE)
    *(.text._ZN7TinyPdfL10AppendSizeERNSt7__cxx1112basic_stringIcSt11char_traitsIcESaIcEEEm)
    *(.text._ZN7TinyPdfL9AppendIntERNSt7__cxx1112basic_stringIcSt11char_traitsIcESaIcEEEi)
    *(.text._ZN6RayoMd4Text11WriteFixed2EPcd)
    *(.text._ZN6RayoMd4Text12AppendFixed2ERNSt7__cxx1112basic_stringIcSt11char_traitsIcESaIcEEEd)
    *(.text._ZNSt10filesystem7__cxx114pathD2Ev)
    *(.text._ZN7TinyPdf10PdfObjects3SetEiONSt7__cxx1112basic_stringIcSt11char_traitsIcESaIcEEE)
    *(.text._ZN7TinyPdf10PdfObjects7SetViewEiSt17basic_string_viewIcSt11char_traitsIcEE)
    *(.text._ZNK7TinyPdf10PdfObjects9WriteTailEPcRKSt6vectorImSaImEEmiiPKc)
    *(.text._ZN7TinyPdf16DocumentMetadataD2Ev)
    *(.text._ZNKSt17basic_string_viewIcSt11char_traitsIcEE7compareEmmPKc)
    *(.text._ZN7TinyPdf13ImageRegistryD2Ev)
    *(.text._ZNSt6vectorINSt7__cxx1112basic_stringIcSt11char_traitsIcESaIcEEESaIS5_EED2Ev)
    *(.text._ZNSt6vectorIiSaIiEED2Ev)
    *(.text._ZNSt6vectorImSaImEED2Ev)
    *(.text._ZNK7TinyPdf10PdfObjects9BuildIntoEiiRNSt7__cxx1112basic_stringIcSt11char_traitsIcESaIcEEEbb)
    *(.text._ZNSt10_HashtableINSt7__cxx1112basic_stringIcSt11char_traitsIcESaIcEEESt4pairIKS5_N7TinyPdf14HeadingTargets6AnchorEESaISB_ENSt8__detail10_Select1stESt8equal_toIS5_ESt4hashIS5_ENSD_18_Mod_range_hashingENSD_20_Default_ranged_hashENSD_20_Prime_rehash_policyENSD_17_Hashtable_traitsILb1ELb0ELb1EEEED2Ev)
    *(.text._ZNSt6vectorIiSaIiEE7reserveEm)
    *(.text._ZNSt6vectorIN7TinyPdf11HeadingMarkESaIS1_EED2Ev)
    *(.text._ZSteqIcSt11char_traitsIcESaIcEEbRKNSt7__cxx1112basic_stringIT_T0_T1_EEPKS5_)
    *(.text._ZNSt6vectorIN7TinyPdf8Internal13ContentsEntryESaIS2_EED2Ev)
    *(.text._ZNSt6vectorIS_IiSaIiEESaIS1_EED2Ev)
    *(.text._ZNSt6vectorIN7TinyPdf8Internal5BlockESaIS2_EED2Ev)
    *(.text._ZN7TinyPdf8Internal9FootnotesD2Ev)
    *(.text._ZNSt10unique_ptrIN7TinyPdf9BookParseESt14default_deleteIS1_EED2Ev)
    *(.text._ZNSt6vectorIN7TinyPdf10PdfObjects6ObjectESaIS2_EED2Ev)
    *(.text._ZNSt6vectorIN7TinyPdf12InternalLinkESaIS1_EED2Ev)
    *(.text._ZNSt6vectorIN7TinyPdf10PdfObjects6ObjectESaIS2_EE17_M_realloc_insertIJEEEvN9__gnu_cxx17__normal_iteratorIPS2_S4_EEDpOT_)
    *(.text._ZNSt6vectorIN7TinyPdf10PdfObjects6ObjectESaIS2_EE12emplace_backIJEEERS2_DpOT_.isra.0)
    *(.text._ZN7TinyPdf10PdfObjects3AddEONSt7__cxx1112basic_stringIcSt11char_traitsIcESaIcEEE)
    *(.text._ZN7TinyPdf10PdfObjects16AddStreamInPlaceERKNSt7__cxx1112basic_stringIcSt11char_traitsIcESaIcEEEmm)
    *(.text._ZNSt10filesystem7__cxx114pathC2IPKcS1_EET_S5_NS1_6formatE)
    *(.text._ZN7TinyPdf16LocalImagePolicyC2ERKNS_10PdfOptionsE)
    *(.text._ZNSt6vectorIS_IiSaIiEESaIS1_EE7reserveEm)
    *(.text._ZNSt13_Bvector_baseISaIbEE13_M_deallocateEv)
    *(.text._ZNSt6vectorIiSaIiEE17_M_realloc_insertIJiEEEvN9__gnu_cxx17__normal_iteratorIPiS1_EEDpOT_)
    *(.text._ZNSt6vectorIN7TinyPdf11HeadingMarkESaIS1_EE17_M_realloc_insertIJS1_EEEvN9__gnu_cxx17__normal_iteratorIPS1_S3_EEDpOT_)
    *(.text._ZNSt6vectorIjSaIjEE17_M_realloc_insertIJjEEEvN9__gnu_cxx17__normal_iteratorIPjS1_EEDpOT_)
    *(.text._ZNSt6vectorIjSaIjEE12emplace_backIJjEEERjDpOT_.isra.0)
    *(.text._ZNSt6vectorImSaImEE17_M_realloc_insertIJmEEEvN9__gnu_cxx17__normal_iteratorIPmS1_EEDpOT_)
    *(.text._ZNSt6vectorIS_IN7TinyPdf8LinkRectESaIS1_EESaIS3_EE17_M_realloc_insertIJS3_EEEvN9__gnu_cxx17__normal_iteratorIPS3_S5_EEDpOT_)
    *(.text._ZN7TinyPdfL13BuildDocumentERKNSt7__cxx1112basic_stringIcSt11char_traitsIcESaIcEEERKNS_10PdfOptionsERS5_RNS_11BuildResultERjPNS_10BookSourceE.constprop.0)
    *(.text._ZN7TinyPdf8BuildPdfERKNSt7__cxx1112basic_stringIcSt11char_traitsIcESaIcEEERKNS_10PdfOptionsERS5_)
    *(.text._ZNSt10filesystem7__cxx114pathC2EONSt7__cxx1112basic_stringIcSt11char_traitsIcESaIcEEENS1_6formatE)
    *(.text._ZNKSt10filesystem7__cxx114path9extensionEv)
    *(.text._ZN7TinyPdf8Internal19ResolveMarginPointsERKNS_9PdfMarginE)
    *(.text._ZN7TinyPdf8Internal15ResolvePageSizeERKNS_11PdfPageSizeE)
    *(.text._ZN7TinyPdf8Internal19ResolveMarginPointsERKNS_9PdfMarginERKNS_11PdfPageSizeE)
    *(.text._ZN7TinyPdf8InternalL9RTrimViewESt17basic_string_viewIcSt11char_traitsIcEE)
    *(.text._ZNKSt17basic_string_viewIcSt11char_traitsIcEE6substrEmm.constprop.1.isra.0)
    *(.text._ZNSt7__cxx1112basic_stringIcSt11char_traitsIcESaIcEEaSEOS4_.isra.0)
    *(.text._ZNSt6vectorISt17basic_string_viewIcSt11char_traitsIcEESaIS3_EE12emplace_backIJPKcmEEERS3_DpOT_.isra.0)
    *(.text._ZN7TinyPdf8InternalL9LTrimViewESt17basic_string_viewIcSt11char_traitsIcEE)
    *(.text._ZN7TinyPdf8InternalL10StartsWithESt17basic_string_viewIcSt11char_traitsIcEES4_)
    *(.text._ZN7TinyPdf8Internal19StripInlineMarkdownB5cxx11ESt17basic_string_viewIcSt11char_traitsIcEEb)
    *(.text._ZN7TinyPdf8InternalL20ParseStandaloneImageESt17basic_string_viewIcSt11char_traitsIcEEPNS0_11ImageSyntaxE)
    *(.text._ZN7TinyPdf8InternalL12ClassifyLineESt17basic_string_viewIcSt11char_traitsIcEE)
    *(.text._ZN7TinyPdf8InternalL21IsSingleParagraphLineESt17basic_string_viewIcSt11char_traitsIcEE)
    *(.text._ZN7TinyPdf8Internal27StripInlineMarkdownKeepMathB5cxx11ESt17basic_string_viewIcSt11char_traitsIcEERb)
    *(.text._ZN7TinyPdf8InternalL14SplitLineViewsERKNSt7__cxx1112basic_stringIcSt11char_traitsIcESaIcEEE)
    *(.text._ZNSt10_HashtableINSt7__cxx1112basic_stringIcSt11char_traitsIcESaIcEEESt4pairIKS5_N7TinyPdf8Internal19ReferenceDefinitionEESaISB_ENSt8__detail10_Select1stESt8equal_toIS5_ESt4hashIS5_ENSD_18_Mod_range_hashingENSD_20_Default_ranged_hashENSD_20_Prime_rehash_policyENSD_17_Hashtable_traitsILb1ELb0ELb1EEEED2Ev)
    *(.text._ZN7TinyPdf8InternalL12IsTableStartERKSt6vectorISt17basic_string_viewIcSt11char_traitsIcEESaIS5_EEmPS1_IiSaIiEE)
    *(.text._ZNSt6vectorIN7TinyPdf8Internal5BlockESaIS2_EE12emplace_backIJEEERS2_DpOT_.isra.0)
    *(.text._ZN7TinyPdf8InternalL17ParseMarkdownImplERKNSt7__cxx1112basic_stringIcSt11char_traitsIcESaIcEEEiPNS0_13FootnoteParseE)
    *(.text._ZN7TinyPdf8Internal18ParseMarkdownLevelERKNSt7__cxx1112basic_stringIcSt11char_traitsIcESaIcEEEiPNS0_13FootnoteParseE)
    *(.text._ZN7TinyPdf8Internal13ParseMarkdownERKNSt7__cxx1112basic_stringIcSt11char_traitsIcESaIcEEEPNS0_9FootnotesE)
    *(.text._ZNSt12_Vector_baseISt4pairINSt7__cxx1112basic_stringIcSt11char_traitsIcESaIcEEES6_ESaIS7_EED2Ev)
    *(.text._ZNSt6vectorISt4pairINSt7__cxx1112basic_stringIcSt11char_traitsIcESaIcEEES6_ESaIS7_EED2Ev)
    *(.text._ZNSt10_HashtableINSt7__cxx1112basic_stringIcSt11char_traitsIcESaIcEEESt4pairIKS5_mESaIS8_ENSt8__detail10_Select1stESt8equal_toIS5_ESt4hashIS5_ENSA_18_Mod_range_hashingENSA_20_Default_ranged_hashENSA_20_Prime_rehash_policyENSA_17_Hashtable_traitsILb1ELb0ELb1EEEE21_M_deallocate_bucketsEv)
    *(.text._ZNSt6vectorIS_IN7TinyPdf8Internal5BlockESaIS2_EESaIS4_EED2Ev)
    *(.text._ZN7TinyPdf8Internal13FootnoteParseD2Ev)
    *(.text._ZN7TinyPdf8Internal18ParseWithFootnotesERKNSt7__cxx1112basic_stringIcSt11char_traitsIcESaIcEEERNS0_9FootnotesE)
    *(.text._ZN7TinyPdf8Internal12_GLOBAL__N_111FirstMarkerERKSt6vectorINS0_5BlockESaIS3_EE)
    *(.text._ZN7TinyPdf8Internal13PlaceContentsERSt6vectorINS0_5BlockESaIS2_EEbi)
    *(.text._ZN6RayoMd4File8WriteAllERKNSt10filesystem7__cxx114pathESt17basic_string_viewIcSt11char_traitsIcEE)
    *(.text._ZNSt10filesystem7__cxx114pathC2IPcS1_EERKT_NS1_6formatE.constprop.0.isra.0)
    *(.text._ZN12_GLOBAL__N_15LowerENSt7__cxx1112basic_stringIcSt11char_traitsIcESaIcEEE)
    *(.text._ZN12_GLOBAL__N_120ReadUtf8FilePortableERKNSt10filesystem7__cxx114pathERNSt7__cxx1112basic_stringIcSt11char_traitsIcESaIcEEE.constprop.0)
    *(.text._ZN7TinyPdf8PdfThemeD2Ev)
    *(.text._ZN12_GLOBAL__N_113PdfOptionsForERKNS_16CliExportOptionsERKNSt7__cxx1112basic_stringIcSt11char_traitsIcESaIcEEE)
    *(.text._ZN12_GLOBAL__N_122BuildNativePdfMarkdownERKNSt7__cxx1112basic_stringIcSt11char_traitsIcESaIcEEES7_RKNSt10filesystem7__cxx114pathERKNS_16CliExportOptionsERS5_S7_PS5_PN7TinyPdf11BuildResultE)
    *(.text._ZN12_GLOBAL__N_118BuildNativePdfFileERKNSt10filesystem7__cxx114pathES4_RKNS_16CliExportOptionsERNSt7__cxx1112basic_stringIcSt11char_traitsIcESaIcEEEPSD_PN7TinyPdf11BuildResultE)
    *(.text._ZN12_GLOBAL__N_118ParseExportOptionsEiPPciRNS_16CliExportOptionsERNSt7__cxx1112basic_stringIcSt11char_traitsIcESaIcEEE.constprop.0)
    *(.text._ZNSt10filesystem7__cxx114pathC2IA5_cS1_EERKT_NS1_6formatE)
    *libstdc++.a:del_ops.o(.text._ZdlPvm)
    *libstdc++.a:guard.o(.text.__cxa_guard_acquire)
    *libstdc++.a:guard.o(.text.__cxa_guard_release)
    *libstdc++.a:new_op.o(.text._Znwm)
    *libstdc++.a:string-inst.o(.text._ZNSt7__cxx1112basic_stringIcSt11char_traitsIcESaIcEE9_M_createERmm)
    *libstdc++.a:string-inst.o(.text._ZNSt7__cxx1112basic_stringIcSt11char_traitsIcESaIcEE10_M_disposeEv)
    *libstdc++.a:string-inst.o(.text._ZNSt7__cxx1112basic_stringIcSt11char_traitsIcESaIcEE12_M_constructEmc)
    *libstdc++.a:string-inst.o(.text._ZNSt7__cxx1112basic_stringIcSt11char_traitsIcESaIcEE9_M_assignERKS4_)
    *libstdc++.a:string-inst.o(.text._ZNSt7__cxx1112basic_stringIcSt11char_traitsIcESaIcEE9_M_mutateEmmPKcm)
    *libstdc++.a:string-inst.o(.text._ZNSt7__cxx1112basic_stringIcSt11char_traitsIcESaIcEEC2EOS4_)
    *libstdc++.a:string-inst.o(.text._ZNSt7__cxx1112basic_stringIcSt11char_traitsIcESaIcEEaSEOS4_)
    *libstdc++.a:string-inst.o(.text._ZNSt7__cxx1112basic_stringIcSt11char_traitsIcESaIcEE7reserveEm)
    *libstdc++.a:string-inst.o(.text._ZNSt7__cxx1112basic_stringIcSt11char_traitsIcESaIcEE14_M_replace_auxEmmmc)
    *libstdc++.a:string-inst.o(.text._ZNSt7__cxx1112basic_stringIcSt11char_traitsIcESaIcEE6resizeEmc)
    *libstdc++.a:string-inst.o(.text._ZNSt7__cxx1112basic_stringIcSt11char_traitsIcESaIcEE10_M_replaceEmmPKcm)
    *libstdc++.a:string-inst.o(.text._ZNSt7__cxx1112basic_stringIcSt11char_traitsIcESaIcEE9_M_appendEPKcm)
    *libstdc++.a:string-inst.o(.text._ZNSt7__cxx1112basic_stringIcSt11char_traitsIcESaIcEE6appendEPKcm)
    *libstdc++.a:string-inst.o(.text._ZNSt7__cxx1112basic_stringIcSt11char_traitsIcESaIcEE6appendEPKc)
    *libstdc++.a:string-inst.o(.text._ZNKSt7__cxx1112basic_stringIcSt11char_traitsIcESaIcEE4findEPKcmm)
    *libstdc++.a:string-inst.o(.text._ZNKSt7__cxx1112basic_stringIcSt11char_traitsIcESaIcEE4findEcm)
    *libstdc++.a:string-inst.o(.text._ZNKSt7__cxx1112basic_stringIcSt11char_traitsIcESaIcEE5rfindEcm)
    *libstdc++.a:string-inst.o(.text._ZNSt7__cxx1112basic_stringIcSt11char_traitsIcESaIcEE12_M_constructIPKcEEvT_S8_St20forward_iterator_tag)
    *libstdc++.a:string-inst.o(.text._ZNKSt7__cxx1112basic_stringIcSt11char_traitsIcESaIcEE6substrEmm)
    *libstdc++.a:system_error.o(.text._ZN12_GLOBAL__N_113constant_initINS_22generic_error_categoryEED2Ev)
    *libstdc++.a:system_error.o(.text._ZN12_GLOBAL__N_113constant_initINS_21system_error_categoryEED2Ev)
    *libstdc++.a:fs_path.o(.text._ZNSt7__cxx1112basic_stringIcSt11char_traitsIcESaIcEE12_M_constructIPKcEEvT_S8_St20forward_iterator_tag.isra.0)
    *libstdc++.a:fs_path.o(.text._ZNKSt10filesystem7__cxx114path5_List13_Impl_deleterclEPNS2_5_ImplE)
    *libstdc++.a:fs_path.o(.text._ZNSt10filesystem7__cxx114path5_ListC2Ev)
    *libstdc++.a:fs_path.o(.text._ZNKSt10filesystem7__cxx114path5_List5beginEv)
    *libstdc++.a:fs_path.o(.text._ZNKSt10filesystem7__cxx114path5_List3endEv)
    *libstdc++.a:fs_path.o(.text._ZNKSt10filesystem7__cxx114path7compareERKS1_)
    *libstdc++.a:fs_path.o(.text._ZNKSt10filesystem7__cxx114path17has_relative_pathEv)
    *libstdc++.a:fs_path.o(.text._ZNKSt10filesystem7__cxx114path12has_filenameEv)
    *libstdc++.a:fs_path.o(.text._ZNKSt10filesystem7__cxx114path17_M_find_extensionEv)
    *libstdc++.a:fs_path.o(.text._ZNSt10filesystem7__cxx114path14_M_split_cmptsEv)
    *libstdc++.a:fs_path.o(.text._ZNSt10filesystem7__cxx114path5_List7reserveEib)
    *libstdc++.a:fs_path.o(.text._ZNKSt10filesystem7__cxx114path5_List5_Impl4copyEv)
    *libstdc++.a:fs_path.o(.text._ZNSt10filesystem7__cxx114path5_ListC2ERKS2_)
    *libstdc++.a:fs_path.o(.text._ZNSt10filesystem7__cxx114path5_ListaSERKS2_)
    *libstdc++.a:fs_path.o(.text._ZNSt10filesystem7__cxx114pathaSERKS1_)
    *libstdc++.a:fs_path.o(.text._ZNKSt10filesystem7__cxx114path11parent_pathEv)
    *libstdc++.a:del_op.o(.text._ZdlPv)
    *libstdc++.a:ios_errcat.o(.text._ZN12_GLOBAL__N_113constant_initD2Ev)
    *(.text.unlikely._ZN7TinyPdfL21AppendPageAnnotationsERNSt7__cxx1112basic_stringIcSt11char_traitsIcESaIcEEERKSt6vectorIiSaIiEE.part.0)
    *(.text.unlikely._ZN7TinyPdfL25AppendLinkAnnotationStartERNSt7__cxx1112basic_stringIcSt11char_traitsIcESaIcEEERKNS_8LinkRectEb)
    *(.text._ZNSt6vectorIhSaIhEED2Ev)
    *(.text._ZNSt6vectorIN7TinyPdf8LinkRectESaIS1_EE17_M_realloc_insertIJS1_EEEvN9__gnu_cxx17__normal_iteratorIPS1_S3_EEDpOT_)
    *(.text._ZN7TinyPdfL11AddLinkRectERSt6vectorINS_8LinkRectESaIS1_EEddddSt17basic_string_viewIcSt11char_traitsIcEE)
    *(.text._ZN7TinyPdf8Internal12_GLOBAL__N_18TrimViewESt17basic_string_viewIcSt11char_traitsIcEE)
    *(.text._ZNSt6vectorIN7TinyPdf8Internal9InlineRunESaIS2_EE17_M_realloc_insertIJEEEvN9__gnu_cxx17__normal_iteratorIPS2_S4_EEDpOT_)
    *(.text._ZNSt6vectorIN7TinyPdf8Internal9InlineRunESaIS2_EE12emplace_backIJEEERS2_DpOT_.isra.0)
    *(.text._ZN7TinyPdf8Internal12_GLOBAL__N_111ParseLinkAtERNS1_13InlineScannerEmmRNS1_10InlineLinkE.constprop.0)
    *(.text._ZN7TinyPdf8Internal15ParseInlineRunsESt17basic_string_viewIcSt11char_traitsIcEERNS0_10InlineRunsEbm)
    *(.text.unlikely._ZN7TinyPdfL16AppendUriLiteralERNSt7__cxx1112basic_stringIcSt11char_traitsIcESaIcEEESt17basic_string_viewIcS3_Eb)
    *(.text._ZNSt6vectorIiSaIiEE17_M_realloc_insertIJRKiEEEvN9__gnu_cxx17__normal_iteratorIPiS1_EEDpOT_)
    *(.text._ZNSt6vectorIhSaIhEE17_M_default_appendEm)
    *(.text._ZNSt6vectorIN7TinyPdf7CodeRunESaIS1_EE17_M_realloc_insertIJS1_EEEvN9__gnu_cxx17__normal_iteratorIPS1_S3_EEDpOT_)
    *(.text._ZN7TinyPdf8InternalL12TableRowBodyESt17basic_string_viewIcSt11char_traitsIcEE)
    *(.text._ZN7TinyPdf8InternalL20IsTableSeparatorCellESt17basic_string_viewIcSt11char_traitsIcEERi.constprop.0)
    *(.text._ZN7TinyPdf8Internal5BlockD2Ev)
    *(.text._ZNSt6vectorINSt7__cxx1112basic_stringIcSt11char_traitsIcESaIcEEESaIS5_EE7reserveEm)
    *(.text._ZNSt6vectorINSt7__cxx1112basic_stringIcSt11char_traitsIcESaIcEEESaIS5_EE12emplace_backIJPKcmEEERS5_DpOT_.isra.0)
    *(.text._ZN7TinyPdf8InternalL13SplitTableRowESt17basic_string_viewIcSt11char_traitsIcEE)
    *(.text._ZN7TinyPdf8InternalL15SplitTableCellsESt17basic_string_viewIcSt11char_traitsIcEE)
    *(.text._ZNSt6vectorIN7TinyPdf8Internal5BlockESaIS2_EE8_M_eraseEN9__gnu_cxx17__normal_iteratorIPS2_S4_EE)
    *(.text._ZZN7TinyPdf8InternalL17ParseMarkdownImplERKNSt7__cxx1112basic_stringIcSt11char_traitsIcESaIcEEEiPNS0_13FootnoteParseEENKUlSt17basic_string_viewIcS4_ESt6vectorIS6_SaIS6_EEE_clESC_SF_)
    *(.text._ZNSt6vectorIN7TinyPdf8Internal5BlockESaIS2_EE12emplace_backIJS2_EEERS2_DpOT_.isra.0)
    *(.text._ZN7TinyPdf8Internal12_GLOBAL__N_19WordTable3AddEPKc)
    *(.text._ZN7TinyPdf8Internal12_GLOBAL__N_17WordsOfEh)
    *(.text._ZN7TinyPdf8Internal12_GLOBAL__N_19CodeLexer3RunEmm)
    *(.text._ZN7TinyPdf8Internal12CodeLanguageESt17basic_string_viewIcSt11char_traitsIcEE)
    *(.text._ZN7TinyPdf8Internal12ClassifyCodeEhSt17basic_string_viewIcSt11char_traitsIcEEPh)
    *(.text._ZN7TinyPdf8Internal9CodeColorEh)
    *(.text._ZN7TinyPdf8Internal12CodeLineTileEh)
    *(.text._ZN6RayoMd4Text12_GLOBAL__N_19ToWinAnsiESt17basic_string_viewIcSt11char_traitsIcEEPNSt7__cxx1112basic_stringIcS4_SaIcEEEPm)
    *(.text._ZN6RayoMd4Text18TranscodeToWinAnsiESt17basic_string_viewIcSt11char_traitsIcEEPNSt7__cxx1112basic_stringIcS3_SaIcEEE)
    *libstdc++.a:string-inst.o(.text._ZNSt7__cxx1112basic_stringIcSt11char_traitsIcESaIcEED2Ev)
    *(.text._ZNSt7__cxx1112basic_stringIcSt11char_traitsIcESaIcEEC2EPKcmRKS3_.isra.0)
    *libstdc++.a:hash_bytes.o(.text._ZSt11_Hash_bytesPKvmm)
    *libstdc++.a:hashtable_c++0x.o(.text._ZNKSt8__detail20_Prime_rehash_policy11_M_next_bktEm)
    *libstdc++.a:hashtable_c++0x.o(.text._ZNKSt8__detail20_Prime_rehash_policy14_M_need_rehashEmmm)
    *libstdc++.a:string-inst.o(.text._ZNSt7__cxx1112basic_stringIcSt11char_traitsIcESaIcEE9push_backEc)
    *(.text.unlikely._ZN7TinyPdfL10AppendHex4ERNSt7__cxx1112basic_stringIcSt11char_traitsIcESaIcEEEt)
    *(.text.unlikely._ZN7TinyPdfL9AppendU32ERNSt7__cxx1112basic_stringIcSt11char_traitsIcESaIcEEEj)
    *(.text.unlikely._ZN7TinyPdfL13SubsetGlyphIdERKSt6vectorItSaItEEt)
    *(.text.unlikely._ZN7TinyPdfL14FontFileHeaderEm)
    *(.text.unlikely._ZZN7TinyPdfL9CanSubsetERKNS_7TtfFontEENKUlPKcjE_clES4_j)
    *(.text.unlikely._ZN7TinyPdfL9CanSubsetERKNS_7TtfFontE)
    *(.text.unlikely._ZN7TinyPdfL16SetPayloadStreamERNS_10PdfObjectsEiSt17basic_string_viewIcSt11char_traitsIcEEbRNSt7__cxx1112basic_stringIcS4_SaIcEEE)
    *(.text.unlikely._ZNK7TinyPdf7TtfFont19CacheCodepointWidthEj)
    *(.text.unlikely._ZN7TinyPdfL9TextWidthERKNS_7TtfFontESt17basic_string_viewIwSt11char_traitsIwEEd)
    *(.text.unlikely._ZN7TinyPdfL16ContentsOverlaysINS_16StandardRendererEEESt6vectorINSt7__cxx1112basic_stringIcSt11char_traitsIcESaIcEEESaIS8_EERT_RKS2_INS_8Internal13ContentsEntryESaISE_EERS2_ImSaImEE.constprop.0)
    *(.text.unlikely._ZN7TinyPdfL16ContentsOverlaysINS_8RendererEEESt6vectorINSt7__cxx1112basic_stringIcSt11char_traitsIcESaIcEEESaIS8_EERT_RKS2_INS_8Internal13ContentsEntryESaISE_EERS2_ImSaImEE.constprop.0)
    *(.text.unlikely._ZN7TinyPdfL14PlanSubsetFontERKNS_7TtfFontERKSt6vectorItSaItEERNS_14SubsetFontPlanE)
    *(.text.unlikely._ZN7TinyPdfL13BetterFontForERKNS_7TtfFontERKSt6vectorItSaItEE)
    *(.text.unlikely._ZN7TinyPdfL21BuildStandardPdfBytesERKNSt7__cxx1112basic_stringIcSt11char_traitsIcESaIcEEES7_bRKNS_10PdfOptionsERS5_RNS_11BuildResultEPKNS_10BookSourceE)
    *(.text.unlikely._ZN7TinyPdfL20BuildUnicodePdfBytesERKNSt7__cxx1112basic_stringIcSt11char_traitsIcESaIcEEERKNS_7TtfFontERKNS_10PdfOptionsERS5_PPS9_RmRNS_11BuildResultEPKNS_10BookSourceE)
    *Scrt1.o(.text)
    *crtbeginS.o(.text)
    *(.text._ZN7TinyPdfL15WriteSubsetFontERKNS_14SubsetFontPlanEPc)
    *(.text._ZNSt23_Sp_counted_ptr_inplaceIKNSt7__cxx1112basic_stringIcSt11char_traitsIcESaIcEEESaIvELN9__gnu_cxx12_Lock_policyE2EE10_M_destroyEv)
    *(.text._ZN7TinyPdfL7ReadU16INS_9FileBytesEEEtRKT_m.part.0.isra.0)
    *(.text._ZNKSt7__cxx1112basic_stringIcSt11char_traitsIcESaIcEE7compareERKS4_.isra.0)
    *(.text._ZSt16__introsort_loopIN9__gnu_cxx17__normal_iteratorIPtSt6vectorItSaItEEEElNS0_5__ops15_Iter_less_iterEEvT_S9_T0_T1_.isra.0)
    *(.text._ZNSt7__cxx1112basic_stringIcSt11char_traitsIcESaIcEE6assignEPKc.isra.0)
    *(.text._ZNKSt17basic_string_viewIcSt11char_traitsIcEE4findEcm.isra.0)
    *(.text._ZNSt11char_traitsIwE4copyEPwPKwm.isra.0)
    *(.text._ZNSt7__cxx1112basic_stringIcSt11char_traitsIcESaIcEE12_M_constructIPcEEvT_S7_St20forward_iterator_tag.isra.0)
    *(.text._ZN7TinyPdfL14WriteUtf8UnitsEPwSt17basic_string_viewIcSt11char_traitsIcEE)
    *(.text._ZNSt23_Sp_counted_ptr_inplaceIKNSt7__cxx1112basic_stringIcSt11char_traitsIcESaIcEEESaIvELN9__gnu_cxx12_Lock_policyE2EE10_M_disposeEv)
    *(.text._ZNKSt8_Rb_treeINSt7__cxx1112basic_stringIcSt11char_traitsIcESaIcEEESt4pairIKS5_N7TinyPdf7TtfFont5TableEESt10_Select1stISB_ESt4lessIS5_ESaISB_EE4findERS7_.isra.0)
    *(.text._ZN7TinyPdf8Internal16NeedsInlineParseESt17basic_string_viewIcSt11char_traitsIcEEh.constprop.0)
    *(.text._ZN7TinyPdfL10Utf8ToWideESt17basic_string_viewIcSt11char_traitsIcEE)
    *(.text._ZNSt8_Rb_treeINSt7__cxx1112basic_stringIcSt11char_traitsIcESaIcEEESt4pairIKS5_N7TinyPdf7TtfFont5TableEESt10_Select1stISB_ESt4lessIS5_ESaISB_EE8_M_eraseEPSt13_Rb_tree_nodeISB_E.isra.0)
    *(.text._ZZN7TinyPdfL13GetCachedFontEvEN10CachedFontD2Ev)
    *(.text._ZN7TinyPdfL16AppendUtf8ToWideERNSt7__cxx1112basic_stringIwSt11char_traitsIwESaIwEEESt17basic_string_viewIcS2_IcEE)
    *(.text._ZN7TinyPdf16StandardRenderer4RectEddddPKcb.constprop.0.isra.0)
    *(.text._ZNSt5mutex4lockEv)
    *(.text._ZNK7TinyPdf7TtfFont4LocaEm)
    *(.text._ZNK7TinyPdf7TtfFont11WidthForCidEt)
    *(.text._ZN7TinyPdfL9TextWidthERKNS_7TtfFontESt17basic_string_viewIwSt11char_traitsIwEEd)
    *(.text._ZN7TinyPdf10PdfObjects15SetStreamWriterEiONSt7__cxx1112basic_stringIcSt11char_traitsIcESaIcEEEmRKNS_16PdfPayloadWriterE)
    *(.text._ZN7TinyPdf18BoundedStringCache3GetERKNSt7__cxx1112basic_stringIcSt11char_traitsIcESaIcEEE)
    *(.text._ZN7TinyPdf16StandardRenderer4TextEdddSt17basic_string_viewIcSt11char_traitsIcEEPKcS6_)
    *(.text._ZN7TinyPdf16StandardRendererD2Ev)
    *(.text._ZN7TinyPdf8RendererD2Ev)
    *(.text._ZNSt16_Sp_counted_baseILN9__gnu_cxx12_Lock_policyE2EE10_M_releaseEv)
    *(.text._ZN7TinyPdf18BoundedStringCacheD2Ev)
    *(.text._ZNSt6vectorINSt7__cxx1112basic_stringIwSt11char_traitsIwESaIwEEESaIS5_EED2Ev)
    *(.text._ZSteqIcSt11char_traitsIcESaIcEEbRKNSt7__cxx1112basic_stringIT_T0_T1_EESA_)
    *(.text._ZNSt6vectorIhSaIhEEC2EmRKhRKS0_)
    *(.text._ZNSt6vectorItSaItEED2Ev)
    *(.text._ZNKSt3mapINSt7__cxx1112basic_stringIcSt11char_traitsIcESaIcEEEN7TinyPdf7TtfFont5TableESt4lessIS5_ESaISt4pairIKS5_S8_EEE2atERSC_)
    *(.text._ZNSt10unique_ptrIN7TinyPdf8Internal10StructTreeESt14default_deleteIS2_EED2Ev)
    *(.text._ZNSt6vectorIN7TinyPdf14SubsetFontPlan5TableESaIS2_EED2Ev)
    *(.text._ZN7TinyPdfL8WrapTextERKNS_7TtfFontESt17basic_string_viewIwSt11char_traitsIwEEdd)
    *(.text._ZNSt6vectorItSaItEE17_M_realloc_insertIJRKtEEEvN9__gnu_cxx17__normal_iteratorIPtS1_EEDpOT_)
    *(.text._ZN7TinyPdfL15AddGlyphClosureERKNS_7TtfFontEtRSt6vectorIhSaIhEERS3_ItSaItEE)
    *(.text._ZN7TinyPdf15SubsetGlyphList3GetEv)
    *(.text._ZN7TinyPdfL12WriteCidTextEPcRKNS_7TtfFontESt17basic_string_viewIwSt11char_traitsIwEERNS_10UsedCidSetE)
    *(.text._ZN7TinyPdf8Renderer9PaintTextEdddSt17basic_string_viewIwSt11char_traitsIwEEPKcbbb)
    *(.text._ZNSt6vectorIN7TinyPdf8Renderer9StyledRunESaIS2_EE17_M_realloc_insertIJEEEvN9__gnu_cxx17__normal_iteratorIPS2_S4_EEDpOT_)
    *(.text._ZNSt6vectorImSaImEE17_M_realloc_insertIJRKmEEEvN9__gnu_cxx17__normal_iteratorIPmS1_EEDpOT_)
    *(.text._ZNSt6vectorIN7TinyPdf16StandardRenderer8AsciiRunESaIS2_EE17_M_realloc_insertIJEEEvN9__gnu_cxx17__normal_iteratorIPS2_S4_EEDpOT_)
    *(.text._ZN7TinyPdf16StandardRenderer14PaintAsciiRunsERKNS0_9AsciiRunsEmmdddddRKNS0_9RunColorsE)
    *(.text._ZN7TinyPdf8Renderer15PaintStyledRunsERKNS0_10StyledRunsEmmdddddRKNS0_9RunColorsEb)
    *(.text._ZN7TinyPdf8Renderer16WrapStyledInlineESt17basic_string_viewIcSt11char_traitsIcEEddRNS0_10StyledRunsE)
    *(.text._ZN7TinyPdf8Renderer7NewPageEv)
    *(.text._ZN7TinyPdf8Renderer15RenderParagraphERKNSt7__cxx1112basic_stringIcSt11char_traitsIcESaIcEEEdd)
    *(.text._ZN7TinyPdf16StandardRenderer7NewPageEv)
    *(.text._ZN7TinyPdfL14WrapAsciiWordsIZNS_16StandardRenderer13RenderHeadingERKNS_8Internal5BlockEdEUlSt17basic_string_viewIcSt11char_traitsIcEEdE_EEvS9_ddNS2_16StandardTextFontET_.constprop.0)
    *(.text._ZN7TinyPdfL14WrapAsciiWordsIZNS_16StandardRenderer15RenderParagraphERKNSt7__cxx1112basic_stringIcSt11char_traitsIcESaIcEEEddEUlSt17basic_string_viewIcS5_EdE_EEvSB_ddNS_8Internal16StandardTextFontET_.constprop.0)
    *(.text._ZNSt6vectorIN7TinyPdf16StandardRenderer12AsciiSegmentESaIS2_EE17_M_realloc_insertIJS2_EEEvN9__gnu_cxx17__normal_iteratorIPS2_S4_EEDpOT_)
    *(.text._ZN7TinyPdf16StandardRenderer15WrapAsciiInlineESt17basic_string_viewIcSt11char_traitsIcEEddhRNS0_9AsciiRunsE.isra.0)
    *(.text._ZN7TinyPdf16StandardRenderer15RenderParagraphERKNSt7__cxx1112basic_stringIcSt11char_traitsIcESaIcEEEdd)
    *(.text._ZNSt8_Rb_treeINSt7__cxx1112basic_stringIcSt11char_traitsIcESaIcEEESt4pairIKS5_N7TinyPdf7TtfFont5TableEESt10_Select1stISB_ESt4lessIS5_ESaISB_EE24_M_get_insert_unique_posERS7_)
    *(.text._ZNSt8_Rb_treeINSt7__cxx1112basic_stringIcSt11char_traitsIcESaIcEEESt4pairIKS5_N7TinyPdf7TtfFont5TableEESt10_Select1stISB_ESt4lessIS5_ESaISB_EE29_M_get_insert_hint_unique_posESt23_Rb_tree_const_iteratorISB_ERS7_)
    *(.text._ZNSt3mapINSt7__cxx1112basic_stringIcSt11char_traitsIcESaIcEEEN7TinyPdf7TtfFont5TableESt4lessIS5_ESaISt4pairIKS5_S8_EEEixEOS5_)
    *(.text._ZN7TinyPdf7TtfFont9ParseLocaEv)
    *(.text._ZN7TinyPdf7TtfFont9ParseCmapEv)
    *(.text._ZN7TinyPdf7TtfFont5ParseEv)
    *(.text._ZN7TinyPdf7TtfFont7TryLoadINSt7__cxx1112basic_stringIcSt11char_traitsIcESaIcEEEEEbRKT_)
    *(.text._ZN7TinyPdfL12RenderBlocksINS_16StandardRendererEEEvRT_RKSt6vectorINS_8Internal5BlockESaIS6_EE)
    *(.text._ZN7TinyPdfL12RenderBlocksINS_8RendererEEEvRT_RKSt6vectorINS_8Internal5BlockESaIS6_EE)
    *(.text._ZN7TinyPdfL21BuildStandardPdfBytesERKNSt7__cxx1112basic_stringIcSt11char_traitsIcESaIcEEES7_bRKNS_10PdfOptionsERS5_RNS_11BuildResultEPKNS_10BookSourceE)
    *(.text._ZNSt10_HashtableINSt7__cxx1112basic_stringIcSt11char_traitsIcESaIcEEESt4pairIKS5_St10shared_ptrIS7_EESaISA_ENSt8__detail10_Select1stESt8equal_toIS5_ESt4hashIS5_ENSC_18_Mod_range_hashingENSC_20_Default_ranged_hashENSC_20_Prime_rehash_policyENSC_17_Hashtable_traitsILb1ELb0ELb1EEEE9_M_rehashEmRKm)
    *(.text._ZN7TinyPdf18BoundedStringCache6InsertERKNSt7__cxx1112basic_stringIcSt11char_traitsIcESaIcEEES6_)
    *(.text._ZN7TinyPdfL20BuildUnicodePdfBytesERKNSt7__cxx1112basic_stringIcSt11char_traitsIcESaIcEEERKNS_7TtfFontERKNS_10PdfOptionsERS5_PPS9_RmRNS_11BuildResultEPKNS_10BookSourceE)
    *(.text._ZN7TinyPdf8Internal22CharacterReferenceNeedESt17basic_string_viewIcSt11char_traitsIcEE)
    *(.text._ZN7TinyPdf8Internal17WinAnsiReferencesC2Ev)
    *(.text._ZN7TinyPdf8Internal17WinAnsiReferencesD2Ev)
    *(.text._ZNK7TinyPdf8Internal12_GLOBAL__N_14Text4MarkEmmh.isra.0)
    *libstdc++.a:tree.o(.text._ZSt29_Rb_tree_insert_and_rebalancebPSt18_Rb_tree_node_baseS0_RS_)
    *libstdc++.a:wstring-inst.o(.text._ZNSt7__cxx1112basic_stringIwSt11char_traitsIwESaIwEE9_M_createERmm)
    *libstdc++.a:wstring-inst.o(.text._ZNSt7__cxx1112basic_stringIwSt11char_traitsIwESaIwEE10_M_disposeEv)
    *libstdc++.a:wstring-inst.o(.text._ZNSt7__cxx1112basic_stringIwSt11char_traitsIwESaIwEE9_M_mutateEmmPKwm)
    *libstdc++.a:wstring-inst.o(.text._ZNSt7__cxx1112basic_stringIwSt11char_traitsIwESaIwEE14_M_replace_auxEmmmw)
    *libstdc++.a:wstring-inst.o(.text._ZNSt7__cxx1112basic_stringIwSt11char_traitsIwESaIwEE6resizeEmw)
    *libstdc++.a:wstring-inst.o(.text._ZNSt7__cxx1112basic_stringIwSt11char_traitsIwESaIwEE10_M_replaceEmmPKwm)
    *libstdc++.a:wstring-inst.o(.text._ZNSt7__cxx1112basic_stringIwSt11char_traitsIwESaIwEE9_M_appendEPKwm)
    *crt1.o(.text)
    *crtbeginT.o(.text)
    *libm-*.a:s_tan.o(.text)
    *libm-*.a:s_sincos.o(.text)
    *libm-*.a:e_atan2.o(.text)
    *libgcc_eh.a:unwind-dw2-fde-dip.o(.text)
    *libc.a:libc-start.o(.text)
    *libc.a:libc-tls.o(.text)
    *libc.a:ctype.o(.text)
    *libc.a:ctype-info.o(.text)
    *libc.a:bsd-_setjmp.o(.text)
    *libc.a:cxa_atexit.o(.text)
    *libc.a:cxa_thread_atexit_impl.o(.text)
    *libc.a:exit.o(.text)
    *libc.a:getenv.o(.text)
    *libc.a:secure-getenv.o(.text)
    *libc.a:genops.o(.text)
    *libc.a:libc-cleanup.o(.text)
    *libc.a:pthread_mutex_conf.o(.text)
    *libc.a:malloc.o(.text)
    *libc.a:memchr.o(.text)
    *libc.a:memcmp.o(.text)
    *libc.a:memcpy.o(.text)
    *libc.a:memmove.o(.text)
    *libc.a:mempcpy.o(.text)
    *libc.a:memset.o(.text)
    *libc.a:stpcpy.o(.text)
    *libc.a:strcasecmp_l.o(.text)
    *libc.a:strchr.o(.text)
    *libc.a:strchrnul.o(.text)
    *libc.a:strcmp.o(.text)
    *libc.a:strcpy.o(.text)
    *libc.a:strcspn.o(.text)
    *libc.a:strdup.o(.text)
    *libc.a:strlen.o(.text)
    *libc.a:strncase_l.o(.text)
    *libc.a:strncmp.o(.text)
    *libc.a:strnlen.o(.text)
    *libc.a:strstr.o(.text)
    *libc.a:memchr-avx2.o(.text.avx)
    *libc.a:memcmp-avx2-movbe.o(.text.avx)
    *libc.a:memmove-avx-unaligned-erms.o(.text.avx)
    *libc.a:memset-avx2-unaligned-erms.o(.text.avx)
    *libc.a:strchr-avx2.o(.text.avx)
    *libc.a:strcspn-sse4.o(.text.sse4.2)
    *libc.a:strlen-avx2.o(.text.avx)
    *libc.a:strncmp-avx2.o(.text.avx)
    *libc.a:wcslen.o(.text)
    *libc.a:wmemchr.o(.text)
    *libc.a:wmemset.o(.text)
    *libc.a:_exit.o(.text)
    *libc.a:close.o(.text)
    *libc.a:fstat64.o(.text)
    *libc.a:open64.o(.text)
    *libc.a:write.o(.text)
    *libc.a:getrlimit64.o(.text)
    *libc.a:brk.o(.text)
    *libc.a:mmap64.o(.text)
    *libc.a:mprotect.o(.text)
    *libc.a:munmap.o(.text)
    *libc.a:sbrk.o(.text)
    *libc.a:setvmaname.o(.text)
    *libc.a:memcpy_chk-nonshared.o(.text)
    *libc.a:dl-debug.o(.text)
    *libc.a:dl-find_object.o(.text)
    *libc.a:dl-load.o(.text)
    *libc.a:dl-origin.o(.text)
    *libc.a:dl-reloc.o(.text)
    *libc.a:dl-tls.o(.text)
    *libc.a:dl-tls_init_tp.o(.text)
    *libc.a:dl-tunables.o(.text)
    *libc.a:dl-cet.o(.text)
    *libc.a:dl-early_allocate.o(.text)
    *libc.a:dl-support.o(.text)
    *libc.a:libc_early_init.o(.text)
    *libc.a:init-first.o(.text)
    *libc.a:setjmp.o(.text)
    *libc.a:sigjmp.o(.text)
    *libc.a:elision-conf.o(.text)
    *libc.a:strrchr.o(.text)
    *libc.a:strsep.o(.text)
    *libc.a:strspn.o(.text)
    *libc.a:strrchr-avx2.o(.text.avx)
    *libc.a:wcsnlen.o(.text)
    *libc.a:init-misc.o(.text)
    *libc.a:strpbrk.o(.text)
    *libc.a:strcasecmp.o(.text)
    *libc.a:strncase.o(.text)
    *libc.a:strncpy.o(.text)
    *libc.a:pthread_mutex_lock.o(.text)
    *libc.a:pthread_mutex_unlock.o(.text)
    *(.text.unlikely._ZN7TinyPdfL14PercentDecodedESt17basic_string_viewIcSt11char_traitsIcEE)
    *(.text.unlikely._ZN7TinyPdfL11HeadingSlugESt17basic_string_viewIcSt11char_traitsIcEE)
    *(.text.unlikely._ZNKSt17basic_string_viewIcSt11char_traitsIcEE6substrEmm.constprop.0.isra.0)
    *(.text.unlikely._ZN7TinyPdf14HeadingTargets5IndexEv)
    *(.text.unlikely._ZN7TinyPdf14HeadingTargets15ReserveFragmentERNS_10PdfObjectsERKNS_8LinkRectESt17basic_string_viewIcSt11char_traitsIcEEmRSt6vectorINS_12InternalLinkESaISB_EE)
    *(.text.unlikely._ZN7TinyPdf14HeadingTargets7ReserveERNS_10PdfObjectsERKNS_8LinkRectERSt6vectorINS_12InternalLinkESaIS7_EE)
    *(.text._ZNSt7__cxx1112basic_stringIwSt11char_traitsIwESaIwEE6appendEPKwm.isra.0)
    *(.text._ZN7TinyPdf16StandardRenderer4RectEddddPKcb.constprop.1.isra.0)
    *(.text._ZN7TinyPdf8Renderer8DrawRectEddddPKc)
    *(.text._ZNSt6vectorIN7TinyPdf8Renderer10StyledRunsESaIS2_EED2Ev)
    *(.text._ZNSt6vectorIN7TinyPdf16StandardRenderer9AsciiRunsESaIS2_EED2Ev)
    *(.text._ZNSt6vectorIiSaIiEE9push_backERKi)
    *(.text._ZNSt10_HashtableINSt7__cxx1112basic_stringIcSt11char_traitsIcESaIcEEESt4pairIKS5_N7TinyPdf14HeadingTargets6AnchorEESaISB_ENSt8__detail10_Select1stESt8equal_toIS5_ESt4hashIS5_ENSD_18_Mod_range_hashingENSD_20_Default_ranged_hashENSD_20_Prime_rehash_policyENSD_17_Hashtable_traitsILb1ELb0ELb1EEEE4findERS7_)
    *(.text._ZNSt6vectorIN7TinyPdf8Renderer9StyledRunESaIS2_EE12emplace_backIJEEERS2_DpOT_.isra.0)
    *(.text._ZNSt6vectorIN7TinyPdf16WrappedAsciiLineESaIS1_EE17_M_realloc_insertIJEEEvN9__gnu_cxx17__normal_iteratorIPS1_S3_EEDpOT_)
    *(.text._ZN7TinyPdfL14WrapAsciiWordsIZNS_L13WrapAsciiTextERKNSt7__cxx1112basic_stringIcSt11char_traitsIcESaIcEEEddNS_8Internal16StandardTextFontERSt6vectorINS_16WrappedAsciiLineESaISC_EEEUlSt17basic_string_viewIcS4_EdE_EEvSH_ddSA_T_)
    *(.text._ZN7TinyPdfL23ForEachWrappedAsciiLineIZNS_L13WrapAsciiTextERKNSt7__cxx1112basic_stringIcSt11char_traitsIcESaIcEEEddNS_8Internal16StandardTextFontERSt6vectorINS_16WrappedAsciiLineESaISC_EEEUlSt17basic_string_viewIcS4_EdE_EEvS8_ddSA_T_.isra.0)
    *(.text._ZNSt6vectorIN7TinyPdf12InternalLinkESaIS1_EE17_M_realloc_insertIJS1_EEEvN9__gnu_cxx17__normal_iteratorIPS1_S3_EEDpOT_)
    *(.text._ZNSt6vectorIN7TinyPdf12InternalLinkESaIS1_EE12emplace_backIJS1_EEERS1_DpOT_.isra.0)
    *(.text._ZN7TinyPdf8Renderer8CodeTileEdRbPKc)
    *(.text._ZN7TinyPdf8Renderer11RenderTableERKSt6vectorIS1_INSt7__cxx1112basic_stringIcSt11char_traitsIcESaIcEEESaIS7_EESaIS9_EERKS1_IiSaIiEE)
    *(.text._ZN7TinyPdf16StandardRenderer8CodeTileEdRbPKc)
    *(.text._ZN7TinyPdf16StandardRenderer11RenderTableERKSt6vectorIS1_INSt7__cxx1112basic_stringIcSt11char_traitsIcESaIcEEESaIS7_EESaIS9_EERKS1_IiSaIiEE)
    *(.text._ZNSt10_HashtableINSt7__cxx1112basic_stringIcSt11char_traitsIcESaIcEEESt4pairIKS5_N7TinyPdf14HeadingTargets6AnchorEESaISB_ENSt8__detail10_Select1stESt8equal_toIS5_ESt4hashIS5_ENSD_18_Mod_range_hashingENSD_20_Default_ranged_hashENSD_20_Prime_rehash_policyENSD_17_Hashtable_traitsILb1ELb0ELb1EEEE12_Scoped_nodeD2Ev)
    *(.text._ZN7TinyPdf16StandardRenderer13PaintCodeRunsEdddSt17basic_string_viewIcSt11char_traitsIcEEPKh)
    *(.text._ZN7TinyPdf16StandardRenderer21RenderHighlightedCodeERKNSt7__cxx1112basic_stringIcSt11char_traitsIcESaIcEEEh)
    *(.text._ZN7TinyPdf16StandardRenderer10RenderCodeERKNS_8Internal5BlockE)
    *(.text._ZN7TinyPdf8Renderer13PaintCodeRunsEdddSt17basic_string_viewIwSt11char_traitsIwEEPKh)
    *(.text._ZN7TinyPdf8Renderer21RenderHighlightedCodeERKNSt7__cxx1112basic_stringIcSt11char_traitsIcESaIcEEEh)
    *(.text._ZN7TinyPdf8Renderer10RenderCodeERKNS_8Internal5BlockE)
    *(.text._ZNSt10_HashtableINSt7__cxx1112basic_stringIcSt11char_traitsIcESaIcEEESt4pairIKS5_N7TinyPdf14HeadingTargets6AnchorEESaISB_ENSt8__detail10_Select1stESt8equal_toIS5_ESt4hashIS5_ENSD_18_Mod_range_hashingENSD_20_Default_ranged_hashENSD_20_Prime_rehash_policyENSD_17_Hashtable_traitsILb1ELb0ELb1EEEE9_M_rehashEmRKm)
    *(.text._ZN7TinyPdf8Internal16ParseInlineSpansESt17basic_string_viewIcSt11char_traitsIcEEbm)
    *(.text._ZN7TinyPdf8InternalL4TrimENSt7__cxx1112basic_stringIcSt11char_traitsIcESaIcEEE.isra.0)
    *(.text._ZNSt6vectorINSt7__cxx1112basic_stringIcSt11char_traitsIcESaIcEEESaIS5_EE17_M_realloc_insertIJPKcmEEEvN9__gnu_cxx17__normal_iteratorIPS5_S7_EEDpOT_)
    *libstdc++.a:wstring-inst.o(.text._ZNSt7__cxx1112basic_stringIwSt11char_traitsIwESaIwEE9push_backEw)
    *libstdc++.a:wstring-inst.o(.text._ZNKSt7__cxx1112basic_stringIwSt11char_traitsIwESaIwEE4findEwm)
    *(.text.unlikely._ZN7TinyPdfL14CodepointWidthERKNS_7TtfFontEjd)
    *(.text.unlikely._ZNK7TinyPdf8Renderer19PlaceWideStyledWordERNS0_10StyledRunsERmRdmmmdd)
    *(.text.unlikely._ZN7TinyPdfL12RenderBlocksINS_8RendererEEEvRT_RKSt6vectorINS_8Internal5BlockESaIS6_EE)
    *(.text._ZNSt7__cxx1112basic_stringIwSt11char_traitsIwESaIwEEaSEOS4_.isra.0)
    *(.text._ZN7TinyPdf8Renderer10QuoteStripEd)
    *(.text._ZNKSt17basic_string_viewIcSt11char_traitsIcEE7compareES2_)
    *(.text._ZNSt6vectorIN7TinyPdf8Renderer10StyledSpanESaIS2_EED2Ev)
    *(.text._ZNSt6vectorIN7TinyPdf8Internal10InlineSpanESaIS2_EED2Ev)
    *(.text._ZNSt6vectorIN7TinyPdf8Renderer10StyledSpanESaIS2_EE7reserveEm)
    *(.text._ZNSt6vectorIS_IN7TinyPdf8Renderer10StyledSpanESaIS2_EESaIS4_EED2Ev)
    *(.text._ZNSt6vectorIS_IN7TinyPdf8Renderer10StyledSpanESaIS2_EESaIS4_EE7reserveEm)
    *(.text._ZNSt6vectorIN7TinyPdf8Renderer10StyledSpanESaIS2_EE12emplace_backIJEEERS2_DpOT_.isra.0)
    *(.text._ZN7TinyPdf8Renderer10WrapStyledERKNSt7__cxx1112basic_stringIcSt11char_traitsIcESaIcEEEdd)
    *(.text._ZN7TinyPdf8Renderer11RenderQuoteERKNSt7__cxx1112basic_stringIcSt11char_traitsIcESaIcEEE)
    *(.text._ZN7TinyPdf8Renderer19RenderQuoteChildrenERKSt6vectorINS_8Internal5BlockESaIS3_EE)
    *(.text._ZN7TinyPdf8Internal12_GLOBAL__N_110ReplaceAllERNSt7__cxx1112basic_stringIcSt11char_traitsIcESaIcEEEPKcSA_)
    *(.text._ZN7TinyPdf8Internal23MatchCharacterReferenceESt17basic_string_viewIcSt11char_traitsIcEEmRj)
    *(.text._ZNSt6vectorIhSaIhEE14_M_fill_assignEmRKh)
    *(.text._ZN7TinyPdf8InternalL14AppendLinkTextESt17basic_string_viewIcSt11char_traitsIcEERNS0_12_GLOBAL__N_19RunWriterEmbbb)
    *(.text._ZN7TinyPdf8InternalL19TableMayReferToNoteERKSt6vectorISt17basic_string_viewIcSt11char_traitsIcEESaIS5_EERKS1_INS0_8LineInfoESaISA_EERKS1_IhSaIhEEm.isra.0)
    *(.text._ZN7TinyPdf8InternalL16FindDisplayCloseESt17basic_string_viewIcSt11char_traitsIcEE)
    *(.text._ZN7TinyPdf8InternalL27UnescapeMarkdownDestinationESt17basic_string_viewIcSt11char_traitsIcEE)
    *(.text._ZN7TinyPdf8InternalL26ExtractMarkdownDestinationESt17basic_string_viewIcSt11char_traitsIcEERNSt7__cxx1112basic_stringIcS3_SaIcEEE)
    *(.text._ZN7TinyPdf8InternalL15TakeAlertMarkerERNSt7__cxx1112basic_stringIcSt11char_traitsIcESaIcEEE)
    *(.text._ZN7TinyPdf8InternalL24ParseReferenceDefinitionERKSt6vectorISt17basic_string_viewIcSt11char_traitsIcEESaIS5_EEmRNSt7__cxx1112basic_stringIcS4_SaIcEEERNS0_19ReferenceDefinitionERm.constprop.0)
    *(.text._ZN7TinyPdf8Internal16NormalizeSymbolsENSt7__cxx1112basic_stringIcSt11char_traitsIcESaIcEEE)
    *libstdc++.a:string-inst.o(.text._ZNSt7__cxx1112basic_stringIcSt11char_traitsIcESaIcEE8_M_eraseEmm)
    *libstdc++.a:wstring-inst.o(.text._ZNSt7__cxx1112basic_stringIwSt11char_traitsIwESaIwEE12_M_constructEmw)
    *libstdc++.a:wstring-inst.o(.text._ZNSt7__cxx1112basic_stringIwSt11char_traitsIwESaIwEE7reserveEm)
    *libc.a:memset-sse2-unaligned-erms.o(.text)
    *libc.a:wmemcpy.o(.text)
    *libc.a:wcslen-avx2.o(.text.avx)
    *libc.a:wmemchr-avx2.o(.text.avx)
    *libc.a:ftruncate64.o(.text)
    *(.text.unlikely._ZN7TinyPdfL15MeasureMathLineINS_8Renderer10StyledSpanEEENS_14MathLineExtentERKNS_8MathPoolERKSt6vectorIT_SaIS8_EEdd)
    *(.text.unlikely._ZN7TinyPdfL10UsableCpusEv)
    *(.text.unlikely._ZNKSt17basic_string_viewIwSt11char_traitsIwEE6substrEmm.isra.0)
    *(.text.unlikely._ZN7TinyPdfL14FootnoteNumberEPKNS_8Internal9FootnotesERKNS0_10InlineSpanE)
    *(.text.unlikely._ZN7TinyPdfL22AppendXObjectResourcesERNSt7__cxx1112basic_stringIcSt11char_traitsIcESaIcEEERKSt6vectorIiSaIiEE.part.0)
    *(.text.unlikely._ZN7TinyPdfL10MathAppendISt6vectorINS_8Renderer10StyledSpanESaIS3_EEEERT_RS1_IS6_SaIS6_EE)
    *(.text.unlikely._ZN7TinyPdf8Renderer14DrawStrokeRectEddddPKcd.constprop.0)
    *(.text.unlikely._ZN7TinyPdfL13MarkWordJoinsINS_8Renderer10StyledSpanEEESt6vectorIhSaIhEERKS3_IT_SaIS6_EEm)
    *(.text.unlikely._ZN7TinyPdfL16DecodeImageBytesERKSt6vectorIhSaIhEERNS_8PdfImageERKNSt7__cxx1112basic_stringIcSt11char_traitsIcESaIcEEE)
    *(.text.unlikely._ZN7TinyPdfL15LayoutMathToFitESt17basic_string_viewIcSt11char_traitsIcEEdbbddPKNS_8Internal16MathFallbackFontERNS4_11MathFormulaE)
    *(.text.unlikely._ZN7TinyPdfL10MathAppendINS_8Renderer10StyledSpanEEERT_RSt6vectorIS3_SaIS3_EE)
    *(.text.unlikely._ZZN7TinyPdf8Renderer13WrapMathWordsERKSt6vectorINS0_10StyledWordESaIS2_EERKS1_IhSaIhEEddENKUlSt17basic_string_viewIwSt11char_traitsIwEEbRKS2_bE_clESE_bSG_b.isra.0)
    *(.text.unlikely._ZN7TinyPdf8Renderer13WrapMathWordsERKSt6vectorINS0_10StyledWordESaIS2_EERKS1_IhSaIhEEdd)
    *(.text.unlikely._ZN7TinyPdf8Renderer17PaintMathTextLineERKSt6vectorINS0_10StyledSpanESaIS2_EEdddPKcb)
    *(.text.unlikely._ZZN7TinyPdfL15RenderMathTableINS_8RendererEEEvRT_RKNS_8Internal5BlockEENKUlRKS2_mmddibE_clISt6vectorISC_INS1_10StyledSpanESaISD_EESaISF_EEEEDaS9_mmddib)
    *(.text.unlikely._ZN7TinyPdf8Renderer12PushMathSpanERSt6vectorINS0_10StyledSpanESaIS2_EERKNS_8Internal10InlineSpanEddb)
    *(.text.unlikely._ZN7TinyPdf8Renderer13MathTextSpansERKNSt7__cxx1112basic_stringIcSt11char_traitsIcESaIcEEEddb)
    *(.text.unlikely._ZN7TinyPdfL18AddMathFontObjectsERNS_10PdfObjectsE)
    *(.text.unlikely._ZN7TinyPdfL10MathAppendINS_8Renderer10StyledWordEEERT_RSt6vectorIS3_SaIS3_EE)
    *(.text.unlikely._ZN7TinyPdf8Renderer14SplitMathWordsERKSt6vectorINS0_10StyledSpanESaIS2_EE.isra.0)
    *(.text.unlikely._ZN7TinyPdf8Renderer12WrapMathTextERKNSt7__cxx1112basic_stringIcSt11char_traitsIcESaIcEEEddb)
    *(.text.unlikely._ZN7TinyPdf8Renderer12WrapMathCellERKNSt7__cxx1112basic_stringIcSt11char_traitsIcESaIcEEEddb)
    *(.text.unlikely._ZN7TinyPdf8Renderer11MarkHeadingEiRKNSt7__cxx1112basic_stringIcSt11char_traitsIcESaIcEEEd.part.0)
    *(.text.unlikely._ZN7TinyPdf8Renderer15RenderMathLinesERKSt6vectorIS1_INS0_10StyledSpanESaIS2_EESaIS4_EEddb)
    *(.text.unlikely._ZN7TinyPdf8Renderer17RenderDisplayMathERKNSt7__cxx1112basic_stringIcSt11char_traitsIcESaIcEEEb)
    *(.text.unlikely._ZN7TinyPdf8Renderer19RenderMathTextLinesERKNSt7__cxx1112basic_stringIcSt11char_traitsIcESaIcEEEidddPKcbb)
    *(.text.unlikely._ZN7TinyPdfL15RenderMathTableINS_8RendererEEEvRT_RKNS_8Internal5BlockE)
    *(.text.unlikely._ZN7TinyPdf8Renderer11RenderAlertERKNS_8Internal5BlockE)
    *(.text._ZN7TinyPdfL12HasUriSchemeESt17basic_string_viewIcSt11char_traitsIcEE)
    *(.text._ZNSt23_Sp_counted_ptr_inplaceIN7TinyPdf8PdfImageESaIvELN9__gnu_cxx12_Lock_policyE2EE10_M_destroyEv)
    *(.text._ZN7TinyPdfL14DecodedPngRowsERKNS_7PngInfoERmS3_.constprop.0)
    *(.text._ZNSt13unordered_mapINSt7__cxx1112basic_stringIcSt11char_traitsIcESaIcEEEN6RayoMd4File5StampESt4hashIS5_ESt8equal_toIS5_ESaISt4pairIKS5_S8_EEED2Ev)
    *(.text._ZN7TinyPdf15DirectRootCacheD2Ev)
    *(.text._ZStplIcSt11char_traitsIcESaIcEENSt7__cxx1112basic_stringIT_T0_T1_EEPKS5_RKS8_.isra.0)
    *(.text._ZNSt6vectorIS_IN7TinyPdf16StandardRenderer9AsciiSpanESaIS2_EESaIS4_EE12emplace_backIJS4_EEERS4_DpOT_.isra.0)
    *(.text._ZN7TinyPdf13ImageRegistry14IsKnownFailureERKNSt7__cxx1112basic_stringIcSt11char_traitsIcESaIcEEERKN6RayoMd4File5StampE.part.0)
    *(.text._ZNSt6vectorIS_IN7TinyPdf8Renderer10StyledSpanESaIS2_EESaIS4_EE12emplace_backIJEEERS4_DpOT_.isra.0)
    *(.text._ZNSt10filesystem7__cxx114pathaSEOS1_.isra.0)
    *(.text._ZNSt6vectorIS_IN7TinyPdf8Renderer10StyledSpanESaIS2_EESaIS4_EE12emplace_backIJS4_EEERS4_DpOT_.isra.0)
    *(.text._ZN7TinyPdfL20DescribeReencodedPngERKNS_7PngInfoERNS_8PdfImageE)
    *(.text._ZNSt7__cxx119to_stringEi)
    *(.text._ZN7TinyPdfL13ReadWholeFileERKNSt7__cxx1112basic_stringIcSt11char_traitsIcESaIcEEERSt6vectorIhSaIhEE)
    *(.text._ZN7TinyPdfL21TryCanonicalForPolicyERKNSt10filesystem7__cxx114pathERS2_)
    *(.text._ZNSt10filesystem7__cxx114pathC2ERKS1_)
    *(.text._ZN7TinyPdf8Renderer19MeasureMathFallbackEPvSt17basic_string_viewIcSt11char_traitsIcEEd)
    *(.text._ZN7TinyPdf8PdfImageC2Ev)
    *(.text._ZZN7TinyPdf8Renderer13WrapMathWordsERKSt6vectorINS0_10StyledWordESaIS2_EERKS1_IhSaIhEEddENKUlvE_clEv)
    *(.text._ZN7TinyPdf8PdfImageD2Ev)
    *(.text._ZNSt23_Sp_counted_ptr_inplaceIN7TinyPdf8PdfImageESaIvELN9__gnu_cxx12_Lock_policyE2EE10_M_disposeEv)
    *(.text._ZN7TinyPdf8PdfImageaSEOS0_.isra.0)
    *(.text._ZNSt13unordered_mapINSt7__cxx1112basic_stringIcSt11char_traitsIcESaIcEEEN7TinyPdf13ImageRegistry11CachedImageESt4hashIS5_ESt8equal_toIS5_ESaISt4pairIKS5_S8_EEED2Ev)
    *(.text._ZN7TinyPdfL16DecodeImageBytesERKSt6vectorIhSaIhEERNS_8PdfImageERKNSt7__cxx1112basic_stringIcSt11char_traitsIcESaIcEEE)
    *(.text._ZN7TinyPdfL9IsHttpUrlESt17basic_string_viewIcSt11char_traitsIcEE)
    *(.text._ZNSt6vectorIN7TinyPdf8Internal8MathItemESaIS2_EED2Ev)
    *(.text._ZNSt6vectorIN7TinyPdf8Renderer10StyledWordESaIS2_EED2Ev)
    *(.text._ZNSt6vectorIdSaIdEEC2EmRKS0_)
    *(.text._ZNSt6vectorIdSaIdEED2Ev)
    *(.text._ZNSt6vectorIN7TinyPdf16StandardRenderer9AsciiSpanESaIS2_EED2Ev)
    *(.text._ZNSt6vectorIN7TinyPdf16StandardRenderer9AsciiSpanESaIS2_EE7reserveEm)
    *(.text._ZNSt6vectorIS_IN7TinyPdf16StandardRenderer9AsciiSpanESaIS2_EESaIS4_EED2Ev)
    *(.text._ZN7TinyPdf8Renderer16EmitMathFallbackEPvRNSt7__cxx1112basic_stringIcSt11char_traitsIcESaIcEEESt17basic_string_viewIcS5_EdddPKc)
    *(.text._ZN7TinyPdf10PdfObjects13AddStreamViewERKNSt7__cxx1112basic_stringIcSt11char_traitsIcESaIcEEESt17basic_string_viewIcS4_E)
    *(.text._ZN7TinyPdf16LocalImagePolicy7ResolveERKNSt7__cxx1112basic_stringIcSt11char_traitsIcESaIcEEERS6_S9_)
    *(.text._ZNSt10_HashtableINSt7__cxx1112basic_stringIcSt11char_traitsIcESaIcEEESt4pairIKS5_iESaIS8_ENSt8__detail10_Select1stESt8equal_toIS5_ESt4hashIS5_ENSA_18_Mod_range_hashingENSA_20_Default_ranged_hashENSA_20_Prime_rehash_policyENSA_17_Hashtable_traitsILb1ELb0ELb1EEEE4findERS7_)
    *(.text._ZNSt10_HashtableINSt7__cxx1112basic_stringIcSt11char_traitsIcESaIcEEESt4pairIKS5_N7TinyPdf13ImageRegistry11CachedImageEESaISB_ENSt8__detail10_Select1stESt8equal_toIS5_ESt4hashIS5_ENSD_18_Mod_range_hashingENSD_20_Default_ranged_hashENSD_20_Prime_rehash_policyENSD_17_Hashtable_traitsILb1ELb0ELb1EEEE4findERS7_)
    *(.text._ZNSt6vectorIN7TinyPdf8Renderer10StyledSpanESaIS2_EE17_M_realloc_insertIJEEEvN9__gnu_cxx17__normal_iteratorIPS2_S4_EEDpOT_)
    *(.text._ZNSt6vectorIS_IS_IN7TinyPdf8Renderer10StyledSpanESaIS2_EESaIS4_EESaIS6_EED2Ev)
    *(.text._ZNSt6vectorIN7TinyPdf16StandardRenderer9AsciiSpanESaIS2_EE17_M_realloc_insertIJEEEvN9__gnu_cxx17__normal_iteratorIPS2_S4_EEDpOT_)
    *(.text._ZNSt6vectorIN7TinyPdf16StandardRenderer9AsciiSpanESaIS2_EE12emplace_backIJEEERS2_DpOT_.isra.0)
    *(.text._ZN7TinyPdf8Renderer7AddLinkEddddSt17basic_string_viewIcSt11char_traitsIcEE)
    *(.text._ZNSt6vectorISt10shared_ptrIKN7TinyPdf8PdfImageEESaIS4_EE17_M_realloc_insertIJS4_EEEvN9__gnu_cxx17__normal_iteratorIPS4_S6_EEDpOT_)
    *(.text._ZNKSt10_HashtableINSt7__cxx1112basic_stringIcSt11char_traitsIcESaIcEEESt4pairIKS5_N7TinyPdf14HeadingTargets6AnchorEESaISB_ENSt8__detail10_Select1stESt8equal_toIS5_ESt4hashIS5_ENSD_18_Mod_range_hashingENSD_20_Default_ranged_hashENSD_20_Prime_rehash_policyENSD_17_Hashtable_traitsILb1ELb0ELb1EEEE4findERS7_)
    *(.text._ZNSt6vectorIN7TinyPdf8MathPool4ItemESaIS2_EE17_M_realloc_insertIJS2_EEEvN9__gnu_cxx17__normal_iteratorIPS2_S4_EEDpOT_)
    *(.text._ZN7TinyPdf8MathPool3AddESt17basic_string_viewIcSt11char_traitsIcEEdbbddPKNS_8Internal16MathFallbackFontE)
    *(.text._ZN7TinyPdf8Internal22ForEachMathTextSegmentIZNS_8Renderer13MathTextSpansERKNSt7__cxx1112basic_stringIcSt11char_traitsIcESaIcEEEddbEUlSt17basic_string_viewIcS6_EbE_EEvSC_T_)
    *(.text._ZSt8_DestroyIPN7TinyPdf8MathPool4ItemEEvT_S4_)
    *(.text._ZNSt6vectorIN7TinyPdf8Renderer10StyledWordESaIS2_EE17_M_realloc_insertIJEEEvN9__gnu_cxx17__normal_iteratorIPS2_S4_EEDpOT_)
    *(.text._ZN7TinyPdf8Renderer10RenderRuleEv)
    *(.text._ZN7TinyPdf8Renderer19RenderImageFallbackERKNS_8Internal5BlockE)
    *(.text._ZN7TinyPdf16StandardRenderer14WrapAsciiLinksERKNSt7__cxx1112basic_stringIcSt11char_traitsIcESaIcEEEdd)
    *(.text._ZNSt10_HashtableINSt7__cxx1112basic_stringIcSt11char_traitsIcESaIcEEESt4pairIKS5_iESaIS8_ENSt8__detail10_Select1stESt8equal_toIS5_ESt4hashIS5_ENSA_18_Mod_range_hashingENSA_20_Default_ranged_hashENSA_20_Prime_rehash_policyENSA_17_Hashtable_traitsILb1ELb0ELb1EEEE9_M_rehashEmRKm)
    *(.text._ZNSt10_HashtableINSt7__cxx1112basic_stringIcSt11char_traitsIcESaIcEEESt4pairIKS5_iESaIS8_ENSt8__detail10_Select1stESt8equal_toIS5_ESt4hashIS5_ENSA_18_Mod_range_hashingENSA_20_Default_ranged_hashENSA_20_Prime_rehash_policyENSA_17_Hashtable_traitsILb1ELb0ELb1EEEE21_M_insert_unique_nodeEmmPNSA_10_Hash_nodeIS8_Lb1EEEm)
    *(.text._ZNSt8__detail9_Map_baseINSt7__cxx1112basic_stringIcSt11char_traitsIcESaIcEEESt4pairIKS6_iESaIS9_ENS_10_Select1stESt8equal_toIS6_ESt4hashIS6_ENS_18_Mod_range_hashingENS_20_Default_ranged_hashENS_20_Prime_rehash_policyENS_17_Hashtable_traitsILb1ELb0ELb1EEELb1EEixERS8_)
    *(.text._ZNSt10_HashtableINSt7__cxx1112basic_stringIcSt11char_traitsIcESaIcEEESt4pairIKS5_iESaIS8_ENSt8__detail10_Select1stESt8equal_toIS5_ESt4hashIS5_ENSA_18_Mod_range_hashingENSA_20_Default_ranged_hashENSA_20_Prime_rehash_policyENSA_17_Hashtable_traitsILb1ELb0ELb1EEEE10_M_emplaceIJS5_RiEEES6_INSA_14_Node_iteratorIS8_Lb0ELb1EEEbESt17integral_constantIbLb1EEDpOT_.isra.0)
    *(.text._ZNSt10_HashtableINSt7__cxx1112basic_stringIcSt11char_traitsIcESaIcEEESt4pairIKS5_N7TinyPdf13ImageRegistry11CachedImageEESaISB_ENSt8__detail10_Select1stESt8equal_toIS5_ESt4hashIS5_ENSD_18_Mod_range_hashingENSD_20_Default_ranged_hashENSD_20_Prime_rehash_policyENSD_17_Hashtable_traitsILb1ELb0ELb1EEEE9_M_rehashEmRKm)
    *(.text._ZN7TinyPdf13ImageRegistry24StoreDecodedImageInCacheERKNSt7__cxx1112basic_stringIcSt11char_traitsIcESaIcEEERKN6RayoMd4File5StampENS_8PdfImageE)
    *(.text._ZN7TinyPdf13ImageRegistry6DecodeERKNSt7__cxx1112basic_stringIcSt11char_traitsIcESaIcEEERKN6RayoMd4File5StampERKSt6vectorIhSaIhEERSt10shared_ptrIKNS_8PdfImageEE)
    *(.text._ZN7TinyPdf13ImageRegistry13ResolveSourceERKNSt7__cxx1112basic_stringIcSt11char_traitsIcESaIcEEES8_Ri.isra.0)
    *(.text._ZN7TinyPdf8Renderer11RenderImageERKNS_8Internal5BlockE)
    *(.text._ZN7TinyPdf8InternalL11FilterBytesEiPKhS2_mmmPh)
    *(.text._ZN7TinyPdf8InternalL16FilterPngRowAvx2EiPKhS2_mmPh)
    *(.text._ZN7TinyPdf8InternalL19ChoosePngFilterAvx2EPKhS2_mm)
    *(.text._ZN7TinyPdf8Internal15ChoosePngFilterEPKhS2_mm)
    *(.text._ZN7TinyPdf8Internal12FilterPngRowEiPKhS2_mmPh)
    *(.text._ZN7TinyPdf8Internal17UnfilterPaethAvx2ILm4EEEvPKhS3_mPh)
    *(.text._ZN7TinyPdf8Internal14UnfilterPngRowEhPKhS2_mmPh)
    *(.text._ZN7TinyPdf8Internal21UnfilterPaethPairAvx2ILm4EEEvPKhS3_S3_mPhS4_)
    *(.text._ZN7TinyPdf8Internal15UnfilterPngRowsEhPKhhS2_S2_mmPhS3_)
    *(.text._ZN6RayoMd5Flate12_GLOBAL__N_114CanonicalCodesEPKhjPt)
    *(.text._ZN6RayoMd5Flate12_GLOBAL__N_111Adler32Avx2EPKhmj)
    *(.text._ZSt16__insertion_sortIPmN9__gnu_cxx5__ops15_Iter_less_iterEEvT_S4_T0_.isra.0)
    *(.text._ZSt16__introsort_loopIPmlN9__gnu_cxx5__ops15_Iter_less_iterEEvT_S4_T0_T1_.isra.0)
    *(.text._ZN6RayoMd5Flate12_GLOBAL__N_112BuildLengthsEPKjjjPh)
    *(.text._ZN6RayoMd5Flate12_GLOBAL__N_110EmitTokensERNS1_9BitWriterEPKjmRKNS1_4CodeE)
    *(.text._ZN6RayoMd5Flate12_GLOBAL__N_19EmitBlockERNS1_9BitWriterEPKhmPKjmS7_S7_b.constprop.0)
    *(.text._ZN6RayoMd5Flate7Adler32EPKhmj)
    *(.text._ZN6RayoMd5Flate14Adler32CombineEjjm)
    *(.text._ZNSt6vectorIjSaIjEE14_M_fill_assignEmRKj)
    *(.text._ZNSt6vectorIjSaIjEE17_M_default_appendEm)
    *(.text._ZN6RayoMd5Flate12_GLOBAL__N_113PrepareTablesEmRNS0_7ScratchERj.constprop.0)
    *(.text._ZN6RayoMd5Flate19DeflateImageSegmentEPKhmmbPhRNS0_7ScratchEPKNS0_13InputProgressE)
    *(.text._ZNSt20__copy_move_backwardILb1ELb1ESt26random_access_iterator_tagE13__copy_move_bIN7TinyPdf8Internal12_GLOBAL__N_17SegmentES6_EEPT0_PT_SA_S8_)
    *(.text._ZNSt10unique_ptrIA_hN7TinyPdf8Internal12_GLOBAL__N_110FreeBufferEED2Ev)
    *(.text._ZNSt15_Deque_iteratorIPN7TinyPdf8Internal18ImagePlanesEncoder5StateERS4_PS4_EppEv.isra.0)
    *(.text._ZZN7TinyPdf8Internal18ImagePlanesEncoderC4EPKmmjENKUlRKNS0_12_GLOBAL__N_17SegmentES7_E_clES7_S7_.isra.0)
    *(.text._ZSt16__insertion_sortIN9__gnu_cxx17__normal_iteratorIPN7TinyPdf8Internal12_GLOBAL__N_17SegmentESt6vectorIS5_SaIS5_EEEENS0_5__ops15_Iter_comp_iterIZNS3_18ImagePlanesEncoderC4EPKmmjEUlRKS5_SH_E_EEEvT_SK_T0_)
    *(.text._ZNSt11__copy_moveILb1ELb1ESt26random_access_iterator_tagE8__copy_mIN7TinyPdf8Internal12_GLOBAL__N_17SegmentES6_EEPT0_PT_SA_S8_)
    *(.text._ZN7TinyPdf8Internal12_GLOBAL__N_110HelperPool3GetEv)
    *(.text._ZSt16__merge_adaptiveIN9__gnu_cxx17__normal_iteratorIPN7TinyPdf8Internal12_GLOBAL__N_17SegmentESt6vectorIS5_SaIS5_EEEElS6_NS0_5__ops15_Iter_comp_iterIZNS3_18ImagePlanesEncoderC4EPKmmjEUlRKS5_SH_E_EEEvT_SK_SK_T0_SL_T1_T2_)
    *(.text._ZSt24__merge_sort_with_bufferIN9__gnu_cxx17__normal_iteratorIPN7TinyPdf8Internal12_GLOBAL__N_17SegmentESt6vectorIS5_SaIS5_EEEES6_NS0_5__ops15_Iter_comp_iterIZNS3_18ImagePlanesEncoderC4EPKmmjEUlRKS5_SH_E_EEEvT_SK_T0_T1_)
    *(.text._ZSt22__stable_sort_adaptiveIN9__gnu_cxx17__normal_iteratorIPN7TinyPdf8Internal12_GLOBAL__N_17SegmentESt6vectorIS5_SaIS5_EEEES6_NS0_5__ops15_Iter_comp_iterIZNS3_18ImagePlanesEncoderC4EPKmmjEUlRKS5_SH_E_EEEvT_SK_SK_T0_T1_)
    *(.text._ZN6RayoMd5Flate16ImageSegmentSizeEm)
    *(.text._ZNK7TinyPdf8Internal18ImagePlanesEncoder5State9ClaimableEmb)
    *(.text._ZN7TinyPdf8Internal18ImagePlanesEncoder5State9NewBufferEv)
    *(.text._ZNSt10lock_guardISt5mutexED2Ev)
    *(.text._ZN7TinyPdf8Internal18ImagePlanesEncoder5State4WakeEv)
    *(.text._ZN7TinyPdf8Internal18ImagePlanesEncoder5State7AdvanceEmm)
    *(.text._ZN7TinyPdf8Internal18ImagePlanesEncoder6CommitEmm)
    *(.text._ZN7TinyPdf8Internal18ImagePlanesEncoder5State5ClaimEb)
    *(.text._ZNSt6vectorIjSaIjEED2Ev)
    *(.text._ZN6RayoMd5Flate7ScratchD2Ev)
    *(.text._ZNSt11unique_lockISt5mutexEC2ERS0_)
    *(.text._ZNSt11unique_lockISt5mutexED2Ev)
    *(.text._ZNSt6vectorIPhSaIS0_EE17_M_realloc_insertIJRKS0_EEEvN9__gnu_cxx17__normal_iteratorIPS0_S2_EEDpOT_)
    *(.text._ZN7TinyPdf8Internal18ImagePlanesEncoder5State6EncodeERNS0_12_GLOBAL__N_17SegmentEb)
    *(.text._ZN7TinyPdf8Internal18ImagePlanesEncoder5State4WorkEv)
    *(.text._ZN7TinyPdf8Internal18ImagePlanesEncoder5State13AcquireBufferEv)
    *(.text._ZN7TinyPdf8Internal18ImagePlanesEncoder5State7WritingEm)
    *(.text._ZN7TinyPdf8Internal18ImagePlanesEncoder7ReserveEmm)
    *(.text._ZN7TinyPdf8Internal18ImagePlanesEncoder6AppendEmPKhm)
    *(.text._ZNSt10unique_ptrINSt6thread6_StateESt14default_deleteIS1_EED2Ev)
    *(.text._ZNSt15_Deque_iteratorIPN7TinyPdf8Internal18ImagePlanesEncoder5StateERS4_PS4_EC2ERKS7_)
    *(.text._ZNSt6thread11_State_implINS_8_InvokerISt5tupleIJZN7TinyPdf8Internal12_GLOBAL__N_110HelperPool7RequestEPNS4_18ImagePlanesEncoder5StateEjEUlvE_EEEEE6_M_runEv)
    *(.text._ZN7TinyPdf8Internal18ImagePlanesEncoder5StateD2Ev)
    *(.text._ZNSt10unique_ptrIN7TinyPdf8Internal18ImagePlanesEncoder5StateESt14default_deleteIS3_EED2Ev)
    *(.text._ZStmiRKSt15_Deque_iteratorIPN7TinyPdf8Internal18ImagePlanesEncoder5StateERS4_PS4_ES9_)
    *(.text._ZN7TinyPdf8Internal18ImagePlanesEncoderC2EPKmmj)
    *(.text._ZNSt5dequeIPN7TinyPdf8Internal18ImagePlanesEncoder5StateESaIS4_EE15_M_erase_at_endESt15_Deque_iteratorIS4_RS4_PS4_E)
    *(.text._ZNSt5dequeIPN7TinyPdf8Internal18ImagePlanesEncoder5StateESaIS4_EE8_M_eraseESt15_Deque_iteratorIS4_RS4_PS4_ESA_)
    *(.text._ZN7TinyPdf8Internal12_GLOBAL__N_110HelperPool6CancelEPNS0_18ImagePlanesEncoder5StateE)
    *(.text._ZN7TinyPdf8Internal18ImagePlanesEncoder5State12LeaveHelpersEv)
    *(.text._ZN7TinyPdf8Internal18ImagePlanesEncoderD2Ev)
    *(.text._ZN7TinyPdf8Internal18ImagePlanesEncoder6FinishEPNSt7__cxx1112basic_stringIcSt11char_traitsIcESaIcEEE)
    *(.text._ZN6RayoMd7Inflate12_GLOBAL__N_110BuildTableINS1_11LitLenEntryEEEbPKhjjPjbbT_.constprop.0)
    *(.text._ZN6RayoMd7Inflate12_GLOBAL__N_110BuildTableINS1_13DistanceEntryEEEbPKhjjPjbbT_.constprop.0)
    *(.text._ZN6RayoMd7Inflate10ZlibReader5State17ReadDynamicTablesEv)
    *(.text._ZN6RayoMd7Inflate10ZlibReader5State11DecodeCodesEm)
    *(.text._ZN6RayoMd7Inflate10ZlibReader5State4FillEm)
    *(.text._ZN6RayoMd7Inflate10ZlibReaderC2Ev)
    *(.text._ZN6RayoMd7Inflate10ZlibReaderD2Ev)
    *(.text._ZN6RayoMd7Inflate10ZlibReader5StartEPKhmmm)
    *(.text._ZN6RayoMd7Inflate10ZlibReader4TakeEm)
    *(.text._ZN6RayoMd7Inflate10ZlibReader6UnreadEm)
    *(.text._ZN6RayoMd7Inflate10ZlibReader6FinishEv)
    *(.text._ZNKSt17basic_string_viewIcSt11char_traitsIcEE6substrEmm)
    *(.text._ZN7TinyPdf8Internal12_GLOBAL__N_121FindExactDelimiterRunESt17basic_string_viewIcSt11char_traitsIcEEmcm.constprop.0)
    *(.text._ZN7TinyPdf8Internal12_GLOBAL__N_113FindMathCloseERNS1_13InlineScannerEmNS1_10MathOpenerE)
    *(.text._ZN7TinyPdf8Internal12_GLOBAL__N_111MatchMathAtERNS1_13InlineScannerEmRNS1_9MathMatchE.constprop.0)
    *(.text._ZN7TinyPdf8Internal12_GLOBAL__N_113InlineScanner15MathEndCoveringERmm)
    *(.text._ZN7TinyPdf8Internal12_GLOBAL__N_113AppendDecodedERNSt7__cxx1112basic_stringIcSt11char_traitsIcESaIcEEESt17basic_string_viewIcS5_E)
    *(.text._ZN7TinyPdf8Internal23NormalizeReferenceLabelB5cxx11ESt17basic_string_viewIcSt11char_traitsIcEE)
    *(.text._ZZN7TinyPdf8Internal15ParseInlineRunsESt17basic_string_viewIcSt11char_traitsIcEERNS0_10InlineRunsEbmENKUlvE_clEv)
    *(.text._ZZN7TinyPdf8Internal15ParseInlineRunsESt17basic_string_viewIcSt11char_traitsIcEERNS0_10InlineRunsEbmENKUlRKNS0_12_GLOBAL__N_19MathMatchEE_clESA_)
    *(.text._ZN7TinyPdf8Internal12_GLOBAL__N_113WriteAutolinkERNS1_9RunWriterERNS0_10InlineRunsESt17basic_string_viewIcSt11char_traitsIcEEmbbb)
    *(.text._ZNKSt10_HashtableINSt7__cxx1112basic_stringIcSt11char_traitsIcESaIcEEESt4pairIKS5_N7TinyPdf8Internal19ReferenceDefinitionEESaISB_ENSt8__detail10_Select1stESt8equal_toIS5_ESt4hashIS5_ENSD_18_Mod_range_hashingENSD_20_Default_ranged_hashENSD_20_Prime_rehash_policyENSD_17_Hashtable_traitsILb1ELb0ELb1EEEE4findERS7_)
    *(.text._ZN7TinyPdf8Internal21ResolveReferenceLinksESt17basic_string_viewIcSt11char_traitsIcEERKSt13unordered_mapINSt7__cxx1112basic_stringIcS3_SaIcEEENS0_19ReferenceDefinitionESt4hashIS9_ESt8equal_toIS9_ESaISt4pairIKS9_SA_EEE)
    *(.text._ZN7TinyPdf8InternalL16JoinTrimmedLinesERKSt6vectorINS0_8LineInfoESaIS2_EEmm)
    *(.text._ZN7TinyPdf8InternalL19ParseReferenceTitleESt17basic_string_viewIcSt11char_traitsIcEERNSt7__cxx1112basic_stringIcS3_SaIcEEE)
    *(.text._ZN7TinyPdf8InternalL18FindMathBlockCloseERKSt6vectorINS0_8LineInfoESaIS2_EEmRSt17basic_string_viewIcSt11char_traitsIcEE.isra.0)
    *(.text._ZN7TinyPdf8InternalL10ImageBlockEONS0_11ImageSyntaxE)
    *(.text._ZNSt6vectorIN7TinyPdf8Internal5BlockESaIS2_EE17_M_realloc_insertIJEEEvN9__gnu_cxx17__normal_iteratorIPS2_S4_EEDpOT_)
    *(.text._ZNSt6vectorIN7TinyPdf8Internal13TableMathCellESaIS2_EE17_M_realloc_insertIJS2_EEEvN9__gnu_cxx17__normal_iteratorIPS2_S4_EEDpOT_)
    *(.text._ZNSt10_HashtableINSt7__cxx1112basic_stringIcSt11char_traitsIcESaIcEEESt4pairIKS5_N7TinyPdf8Internal19ReferenceDefinitionEESaISB_ENSt8__detail10_Select1stESt8equal_toIS5_ESt4hashIS5_ENSD_18_Mod_range_hashingENSD_20_Default_ranged_hashENSD_20_Prime_rehash_policyENSD_17_Hashtable_traitsILb1ELb0ELb1EEEE9_M_rehashEmRKm)
    *(.text._ZN7TinyPdf8Internal12_GLOBAL__N_19CodeLexer6StringEmmmcj)
    *(.text._ZN7TinyPdf8Internal12_GLOBAL__N_19CodeLexer5QuoteEmmm)
    *(.text._ZN7TinyPdf8Internal12_GLOBAL__N_116EqualsIgnoreCaseESt17basic_string_viewIcSt11char_traitsIcEENS1_4NameE)
    *(.text._ZN7TinyPdf8Internal12_GLOBAL__N_120StartsWithIgnoreCaseESt17basic_string_viewIcSt11char_traitsIcEENS1_4NameE)
    *(.text._ZN7TinyPdf8Internal12LooksLikeSvgESt17basic_string_viewIcSt11char_traitsIcEE)
    *(.text._ZN7TinyPdf8Internal12_GLOBAL__N_17IsSpaceEh)
    *(.text._ZN7TinyPdf8Internal12_GLOBAL__N_16DecodeEPKcmmRm)
    *(.text._ZN7TinyPdf8Internal12_GLOBAL__N_16Parser8LinkFromEm)
    *(.text._ZN7TinyPdf8Internal12_GLOBAL__N_16Parser5EnterEv)
    *(.text._ZNK7TinyPdf8Internal12_GLOBAL__N_16Parser13MatchingBraceEj)
    *(.text._ZNK7TinyPdf8Internal12_GLOBAL__N_16Parser15InBalancedGroupEv)
    *(.text._ZN7TinyPdf8Internal12_GLOBAL__N_16Parser6IsCharERKNS1_5TokenEj)
    *(.text._ZN7TinyPdf8Internal12_GLOBAL__N_16Parser8TakeStarEv)
    *(.text._ZN7TinyPdf8Internal12_GLOBAL__N_14TrimESt17basic_string_viewIcSt11char_traitsIcEE)
    *(.text._ZN7TinyPdf8Internal12_GLOBAL__N_19IsControlEh)
    *(.text._ZN7TinyPdf8Internal12_GLOBAL__N_16Parser6SkipWsEv)
    *(.text._ZNK7TinyPdf8Internal12_GLOBAL__N_16Parser11PeekEnvNameEjRSt17basic_string_viewIcSt11char_traitsIcEERj)
    *(.text._ZNK7TinyPdf8Internal12_GLOBAL__N_16Parser11FindTextEndEj)
    *(.text._ZN7TinyPdf8Internal12_GLOBAL__N_110AppendUtf8ERNSt7__cxx1112basic_stringIcSt11char_traitsIcESaIcEEEj)
    *(.text._ZN7TinyPdf8Internal12_GLOBAL__N_16Parser15SkipRowSepDimenEv)
    *(.text._ZN7TinyPdf8Internal12_GLOBAL__N_16Parser8SetClassEtNS0_9MathClassE.constprop.0.isra.0)
    *(.text._ZN7TinyPdf8Internal12_GLOBAL__N_16Parser11ResolveBinsEm)
    *(.text._ZNSt12_Vector_baseIN7TinyPdf8Internal8MathNodeESaIS2_EE11_M_allocateEm.isra.0)
    *(.text._ZN7TinyPdf8Internal12_GLOBAL__N_16Parser6KindOfERKNS1_5TokenE.isra.0)
    *(.text._ZNK7TinyPdf8Internal12_GLOBAL__N_16Parser8IsRowSepERKNS1_5TokenE.isra.0)
    *(.text._ZN7TinyPdf8Internal12_GLOBAL__N_111FindCommandESt17basic_string_viewIcSt11char_traitsIcEE)
    *(.text._ZN7TinyPdf8Internal12_GLOBAL__N_16Parser4PeekEv)
    *(.text._ZN7TinyPdf8Internal12_GLOBAL__N_16Parser4TakeEv)
    *(.text._ZN7TinyPdf8Internal12_GLOBAL__N_16Parser10ParseDelimEv)
    *(.text._ZNK7TinyPdf8Internal12_GLOBAL__N_16Parser6IsStopERKNS1_5TokenE)
    *(.text._ZN7TinyPdf8Internal12_GLOBAL__N_16ParserD2Ev)
    *(.text._ZN7TinyPdf8Internal8MathNodeC2Ev)
    *(.text._ZNSt6vectorIN7TinyPdf8Internal8MathNodeESaIS2_EE12emplace_backIJEEERS2_DpOT_.isra.0)
    *(.text._ZN7TinyPdf8Internal12_GLOBAL__N_16Parser7NewNodeENS0_12MathNodeKindENS0_9MathClassE)
    *(.text._ZN7TinyPdf8Internal12_GLOBAL__N_16Parser4WrapEth)
    *(.text._ZN7TinyPdf8Internal12_GLOBAL__N_16Parser8NewGlyphENS0_9MathClassEhjh)
    *(.text._ZN7TinyPdf8Internal12_GLOBAL__N_16Parser9AsciiNodeEh)
    *(.text._ZN7TinyPdf8Internal12_GLOBAL__N_16Parser13DelimiterAtomEiNS0_9MathClassE)
    *(.text._ZN7TinyPdf8Internal12_GLOBAL__N_16Parser8NewSpaceEii)
    *(.text._ZN7TinyPdf8Internal12_GLOBAL__N_16Parser8NewUnaryENS0_12MathNodeKindENS0_9MathClassEthh)
    *(.text._ZN7TinyPdf8Internal12_GLOBAL__N_16Parser6NewRowEtRKNS1_6RowTagEi)
    *(.text._ZN7TinyPdf8Internal12_GLOBAL__N_15ResetERNS0_15MathParseResultEm)
    *(.text._ZN7TinyPdf8Internal12_GLOBAL__N_110IndexStack4PushEt)
    *(.text._ZN7TinyPdf8Internal12_GLOBAL__N_16Parser10ScriptBaseEm)
    *(.text._ZN7TinyPdf8Internal12_GLOBAL__N_16Parser12AttachScriptEmit.part.0)
    *(.text._ZN7TinyPdf8Internal12_GLOBAL__N_16Parser8TextWordEmhPKcm)
    *(.text._ZN7TinyPdf8Internal12_GLOBAL__N_16Parser6OpNameESt17basic_string_viewIcSt11char_traitsIcEENS0_9MathClassEhm)
    *(.text._ZN7TinyPdf8Internal12_GLOBAL__N_16Parser9MakeArrayENS0_9MathClassEiihtRKNS1_4RowsEhhRKNS1_10ColumnSpecE)
    *(.text._ZN7TinyPdf8Internal12_GLOBAL__N_16Parser7CommandEi)
    *(.text._ZN7TinyPdf8Internal12_GLOBAL__N_16Parser8CharNodeEj)
    *(.text._ZN7TinyPdf8Internal12_GLOBAL__N_16Parser12ParsePrimaryEv)
    *(.text._ZN7TinyPdf8Internal12_GLOBAL__N_16Parser9ParseTextEhm)
    *(.text._ZN7TinyPdf8Internal12_GLOBAL__N_16Parser12ParseTextArgEhm)
    *(.text._ZN7TinyPdf8Internal12_GLOBAL__N_16Parser10ParseItemsEb)
    *(.text._ZN7TinyPdf8Internal12_GLOBAL__N_16Parser9ParseRowsEhbbRNS1_4RowsE)
    *(.text._ZN7TinyPdf8Internal12_GLOBAL__N_16Parser14ParseGroupBodyEv)
    *(.text._ZN7TinyPdf8Internal12_GLOBAL__N_16Parser8ParseArgEv)
    *(.text._ZN7TinyPdf8Internal12_GLOBAL__N_16Parser13ParseOptionalERt.constprop.0.isra.0)
    *(.text._ZN7TinyPdf8Internal9ParseMathESt17basic_string_viewIcSt11char_traitsIcEEbbRNS0_15MathParseResultE)
    *(.text._ZN7TinyPdf8Internal12_GLOBAL__N_113RuleThicknessEd)
    *(.text._ZN7TinyPdf8Internal12_GLOBAL__N_19SurdWidthEdd)
    *(.text._ZNK7TinyPdf8Internal12_GLOBAL__N_18Layouter4NodeEj)
    *(.text._ZN7TinyPdf8Internal12_GLOBAL__N_18Layouter5CoverERNS1_3BoxERKS3_d)
    *(.text._ZNK7TinyPdf8Internal12_GLOBAL__N_18Layouter8FitRatioEdd)
    *(.text._ZZN7TinyPdf8Internal12_GLOBAL__N_19EmitShapeERNSt7__cxx1112basic_stringIcSt11char_traitsIcESaIcEEERKNS0_8MathItemEddRxENKUldE_clEd)
    *(.text._ZNSt27__uninitialized_default_n_1ILb0EE18__uninit_default_nIPN7TinyPdf8Internal12_GLOBAL__N_13BoxEmEET_S7_T0_)
    *(.text._ZNKSt6vectorIN7TinyPdf8Internal12_GLOBAL__N_13BoxESaIS3_EE12_M_check_lenEmPKc)
    *(.text._ZN7TinyPdf8Internal12_GLOBAL__N_16Round2Ed)
    *(.text._ZNSt12_Vector_baseIN7TinyPdf8Internal12_GLOBAL__N_13BoxESaIS3_EE11_M_allocateEm.isra.0)
    *(.text._ZNSt12_Vector_baseIN7TinyPdf8Internal8MathItemESaIS2_EE11_M_allocateEm.isra.0)
    *(.text._ZNSt7__cxx1112basic_stringIcSt11char_traitsIcESaIcEEpLEPKc.isra.0)
    *(.text._ZNK7TinyPdf8Internal12_GLOBAL__N_18Layouter5CloseERNS1_3BoxE.isra.0)
    *(.text._ZNK7TinyPdf8Internal12_GLOBAL__N_18Layouter4OpenEv.isra.0)
    *(.text._ZN7TinyPdf8Internal12_GLOBAL__N_18Layouter5ShiftERKNS1_3BoxEdd.isra.0)
    *(.text._ZSt14__relocate_a_1IPN7TinyPdf8Internal12_GLOBAL__N_13BoxES4_SaIS3_EET0_T_S7_S6_RT1_.isra.0)
    *(.text._ZNSt6vectorIN7TinyPdf8Internal12_GLOBAL__N_13BoxESaIS3_EE6resizeEm)
    *(.text._ZNSt6vectorIN7TinyPdf8Internal12_GLOBAL__N_13BoxESaIS3_EED2Ev)
    *(.text._ZN7TinyPdf8Internal26MathSymbolDescriptorObjectB5cxx11Ev)
    *(.text._ZN7TinyPdf8Internal15MathParseResultD2Ev)
    *(.text._ZSt3maxIdET_St16initializer_listIS0_E)
    *(.text._ZN7TinyPdf8Internal12_GLOBAL__N_16NumberERNSt7__cxx1112basic_stringIcSt11char_traitsIcESaIcEEEd)
    *(.text._ZN7TinyPdf8Internal12_GLOBAL__N_17PathOut5PointEdd)
    *(.text._ZN7TinyPdf8Internal12_GLOBAL__N_17PathOut4LineEdd)
    *(.text._ZN7TinyPdf8Internal12_GLOBAL__N_17PathOut4MoveEdd)
    *(.text._ZN7TinyPdf8Internal12_GLOBAL__N_17PathOut7PolygonEPKdiPKc)
    *(.text._ZN7TinyPdf8Internal12_GLOBAL__N_17PathOut5CurveEdddddd)
    *(.text._ZN7TinyPdf8Internal12_GLOBAL__N_19LineWidthERNSt7__cxx1112basic_stringIcSt11char_traitsIcESaIcEEEdRx)
    *(.text._ZN7TinyPdf8Internal12_GLOBAL__N_19EmitShapeERNSt7__cxx1112basic_stringIcSt11char_traitsIcESaIcEEERKNS0_8MathItemEddRx)
    *(.text._ZNK7TinyPdf8Internal11MathFormula4EmitERNSt7__cxx1112basic_stringIcSt11char_traitsIcESaIcEEEddPKc)
    *(.text._ZN7TinyPdf8Internal14MathFontObjectB5cxx11Eii)
    *(.text._ZN7TinyPdf8Internal12_GLOBAL__N_18Layouter4PushERKNS0_8MathItemE)
    *(.text._ZN7TinyPdf8Internal12_GLOBAL__N_18Layouter5GlyphEdddjjj)
    *(.text._ZN7TinyPdf8Internal12_GLOBAL__N_18Layouter8GlyphBoxEjjjd)
    *(.text._ZN7TinyPdf8Internal12_GLOBAL__N_18Layouter4RuleEdddd)
    *(.text._ZN7TinyPdf8Internal12_GLOBAL__N_18Layouter5ShapeEjdddddj)
    *(.text._ZN7TinyPdf8Internal12_GLOBAL__N_18Layouter11LayoutBigOpERKNS0_8MathNodeENS1_5StyleE.isra.0)
    *(.text._ZN7TinyPdf8Internal12_GLOBAL__N_18Layouter15LayoutDelimiterEjdNS1_5StyleEb.isra.0)
    *(.text._ZN7TinyPdf8Internal12_GLOBAL__N_18Layouter10LayoutNodeEjNS1_5StyleE)
    *(.text._ZN7TinyPdf8Internal12_GLOBAL__N_18Layouter10LayoutListEjNS1_5StyleEj)
    *(.text._ZN7TinyPdf8Internal12_GLOBAL__N_18Layouter5FieldEjNS1_5StyleEj)
    *(.text._ZN7TinyPdf8Internal12_GLOBAL__N_18Layouter3RunERKNS0_15MathParseResultEdb)
    *(.text._ZN7TinyPdf8Internal11MathFormula12LayoutParsedERKNS0_15MathParseResultESt17basic_string_viewIcSt11char_traitsIcEEdbPKNS0_16MathFallbackFontEdbd)
    *(.text._ZN7TinyPdf8Internal11MathFormula6LayoutESt17basic_string_viewIcSt11char_traitsIcEEdbPKNS0_16MathFallbackFontEdbd)
    *(.text._ZN7TinyPdf8Internal12_GLOBAL__N_18Layouter12LayoutAccentERKNS0_8MathNodeENS1_5StyleE.isra.0)
    *(.text._ZN6RayoMd4File7StampOfERKNSt10filesystem7__cxx114pathE)
    *(.text._ZN6RayoMd4File7ReadAllERKNSt10filesystem7__cxx114pathEmRSt6vectorIhSaIhEE)
    *(.text._ZN6RayoMd9ExactMath4CeilEd)
    *(.text._ZN6RayoMd9ExactMath7LlRoundEd)
    *libstdc++.a:atexit_thread.o(.text.__cxa_thread_atexit)
    *libstdc++.a:del_opv.o(.text._ZdaPv)
    *libstdc++.a:new_opnt.o(.text._ZnwmRKSt9nothrow_t)
    *libstdc++.a:new_opv.o(.text._Znam)
    *libstdc++.a:new_opvnt.o(.text._ZnamRKSt9nothrow_t)
    *libstdc++.a:condition_variable.o(.text._ZNSt18condition_variableC2Ev)
    *libstdc++.a:condition_variable.o(.text._ZNSt18condition_variableD2Ev)
    *libstdc++.a:condition_variable.o(.text._ZNSt18condition_variable4waitERSt11unique_lockISt5mutexE)
    *libstdc++.a:condition_variable.o(.text._ZNSt18condition_variable10notify_allEv)
    *libstdc++.a:string-inst.o(.text._ZNSt7__cxx1112basic_stringIcSt11char_traitsIcESaIcEE13_S_copy_charsEPcPKcS7_)
    *libstdc++.a:string-inst.o(.text._ZNKSt7__cxx1112basic_stringIcSt11char_traitsIcESaIcEE17find_first_not_ofEcm)
    *libstdc++.a:system_error.o(.text._ZNSt3_V215system_categoryEv)
    *libstdc++.a:system_error.o(.text._ZNSt3_V216generic_categoryEv)
    *libstdc++.a:thread.o(.text.execute_native_thread_routine)
    *libstdc++.a:thread.o(.text._ZNSt6thread6detachEv)
    *libstdc++.a:thread.o(.text._ZNSt6thread15_M_start_threadESt10unique_ptrINS_6_StateESt14default_deleteIS1_EEPFvvE)
    *libstdc++.a:wstring-inst.o(.text._ZNSt7__cxx1112basic_stringIwSt11char_traitsIwESaIwEE9_M_assignERKS4_)
    *libstdc++.a:fs_ops.o(.text._ZNSt7__cxx1112basic_stringIcSt11char_traitsIcESaIcEE12_M_constructIPKcEEvT_S8_St20forward_iterator_tag.isra.0)
    *libstdc++.a:fs_ops.o(.text._ZNSt10filesystem8absoluteERKNS_7__cxx114pathERSt10error_code)
    *libstdc++.a:fs_ops.o(.text._ZNSt10filesystem9canonicalERKNS_7__cxx114pathERSt10error_code)
    *libstdc++.a:fs_path.o(.text._ZNKSt10filesystem7__cxx114path18has_root_directoryEv)
    *libstdc++.a:fs_path.o(.text._ZNSt10filesystem7__cxx114pathdVERKS1_)
    *libstdc++.a:fs_path.o(.text._ZNKSt10filesystem7__cxx114path16lexically_normalEv)
    *libc.a:errno-loc.o(.text)
    *libc.a:canonicalize.o(.text)
    *libc.a:_itoa.o(.text)
    *libc.a:iofclose.o(.text)
    *libc.a:iofopen.o(.text)
    *libc.a:iofread.o(.text)
    *libc.a:vsnprintf.o(.text)
    *libc.a:fseeko.o(.text)
    *libc.a:ftello.o(.text)
    *libc.a:fileops.o(.text)
    *libc.a:pthread_cond_broadcast.o(.text)
    *libc.a:pthread_cond_destroy.o(.text)
    *libc.a:pthread_cond_wait.o(.text)
    *libc.a:pthread_create.o(.text)
    *libc.a:pthread_detach.o(.text)
    *libc.a:pthread_getattr_default_np.o(.text)
    *libc.a:strchrnul-avx2.o(.text.avx)
    *libc.a:strstr-sse2-unaligned.o(.text)
    *libc.a:sched_cpucount.o(.text)
    *libc.a:sched_getaffinity.o(.text)
    *libc.a:fstatat64.o(.text)
    *libc.a:lseek64.o(.text)
    *libc.a:read.o(.text)
    *libc.a:readlink.o(.text)
    *libc.a:stat64.o(.text)
    *libc.a:close_nocancel.o(.text)
    *libc.a:getpagesize.o(.text)
    *libc.a:madvise.o(.text)
    *libc.a:clone-internal.o(.text)
    *libc.a:clone3.o(.text)
    *libc.a:memset_chk-nonshared.o(.text)
    *libc.a:dl-open.o(.text)
    *libc.a:libc_sigaction.o(.text)
    *libc.a:printf_buffer_done.o(.text)
    *libc.a:snprintf.o(.text)
    *libc.a:vfprintf-internal.o(.text)
    *libc.a:filedoalloc.o(.text)
    *libc.a:ioseekoff.o(.text)
    *libc.a:cancellation.o(.text)
    *libc.a:cleanup_compat.o(.text)
    *libc.a:futex-internal.o(.text)
    *libc.a:nptl-stack.o(.text)
    *libc.a:pthread_attr_copy.o(.text)
    *libc.a:pthread_attr_destroy.o(.text)
    *libc.a:clone.o(.text)
    *libc.a:printf_buffer_write.o(.text)
  }
}
INSERT BEFORE .text;
